## arch/arm/include/cust/PSWIFI/Kconfig
```kconfig
if CUST_PANTECH_H

###################################################
#           PANTECH PSWIFI part Feature              #
###################################################

config PANTECH_PS_WIFI_COM_PREF_LOGGING
       bool "PANTECH PS WIFI COM PREF LOGGING"
       default y

endif
```

## arch/arm64/cust/Kconfig
```kconfig
if CUST_PANTECH_H
#
# CUST PANTECH CONFIG SECTION
#

menu "CUST PANTECH CONFIG SECTION"

config PANTECH
	bool "PANTECH Common Configuration"
	default y
	help
		Support PANTECH

config PANTECH_DOMESTIC
	depends on (MACH_MSM8937_EF71IE || MACH_MSM8937_EF71S || MACH_MSM8937_EF71K )
	bool
	default y
	help
		Pantech Domestic Configuration

config EV10
	int "Pantech Board Version EV10 Value"
	default 0

config PT10
	int "Pantech Board Version PT10 Value"
	default 10

config PT20
	int "Pantech Board Version PT20 Value"
	default 12

config WS10
	int "Pantech Board Version WS10 Value"
	default 20

config WS20
	int "Pantech Board Version WS20 Value"
	default 22

config TP10
	int "Pantech Board Version TP10 Value"
	default 30

config TP20
	int "Pantech Board Version TP20 Value"
	default 32

config BOARD_VER
	int "Pantech Board Version Build Target"
	default 0
        help
          The BOARD_VER is your build target's board version.

config PANTECH_USER_BUILD
	bool "Pantech User Build Target"
	default n
	help
		The PANTECH_USER_BUILD is true if you configure build to user.
		
endmenu

config PANTECH_PDL_DLOAD
	bool "pantech pdl dload"
	default y
		help 
		  We use the "FEATURE_PANTECH_PDL_DLOAD".

source "arch/arm64/include/cust/SIO/Kconfig"
source "arch/arm64/include/cust/LCD/Kconfig"
source "arch/arm64/include/cust/PMIC/Kconfig"
source "arch/arm64/include/cust/FS/Kconfig"
source "arch/arm64/include/cust/SecureBoot/Kconfig"
source "arch/arm64/include/cust/PSWIFI/Kconfig"
############################
# PANTECH DEBUG LOGGING & DUMP START
############################

#############
# ALLWAYS ON #
#############

config PANTECH_ERR_CRASH_LOGGING
    bool
    default n

config PANTECH_DEBUG_ON
  bool
  default n
  select PANTECH_DEBUG

config PANTECH_DEBUG
  bool
  default n
  select PANTECH_DEBUG_SCHED_LOG
  select PANTECH_DEBUG_IRQ_LOG
  select PANTECH_DEBUG_DCVS_LOG
  select PANTECH_DEBUG_RPM_LOG

config PANTECH_DEBUG_SCHED_LOG
  bool
  default n

config PANTECH_DEBUG_IRQ_LOG
  bool
  default n

config PANTECH_DEBUG_DCVS_LOG
  bool
  default n

config PANTECH_DEBUG_RPM_LOG
  bool
  default n

############################
# PANTECH DEBUG LOGGING & DUMP END
############################

############################
# PANTECH SOUND START
############################
config PANTECH_SND
  bool
  default y

config PANTECH_SND_QCOM_PATCH
  bool
  default y
  
config PANTECH_SND_BOOTUP_HEADSET_INFO
  bool
  default y  
  
############################
# PANTECH SOUND END
############################  
endif
```

## arch/arm64/include/cust/FS/Kconfig
```kconfig
if CUST_PANTECH_H

###################################################
# PANTECH FS Feature Section         
#                                                 
###################################################
if MACH_MSM8937_EF71S
config DEFINE_LIST_EF71S
        bool
        default y
        select PANTECH_FS_AUTO_REPAIR
        select PANTECH_SDXC_EXFAT
        select NLS_UTF8
endif

if MACH_MSM8937_EF71K
config DEFINE_LIST_EF71K
        bool
        default y
        select PANTECH_FS_AUTO_REPAIR
        select PANTECH_SDXC_EXFAT
        select NLS_UTF8
endif

if MACH_MSM8937_EF71L
config DEFINE_LIST_EF71L
        bool
        default y
        select PANTECH_FS_AUTO_REPAIR
        select PANTECH_SDXC_EXFAT
        select NLS_UTF8

endif

if MACH_MSM8937_EF71IE
config DEFINE_LIST_EF71IE
        bool
        default y
        select PANTECH_FS_AUTO_REPAIR
        select PANTECH_SDXC_EXFAT
        select NLS_UTF8

endif



##############################################################
# owner  : unknown        
# date    : unknown
# PLM    : 
# Case  :  
# Description : auto refair function		
##############################################################

config PANTECH_FS_AUTO_REPAIR
	bool

##############################################################
# owner  : unknown        
# date    : unknown
# PLM    : 
# Case  :  
# Description : exfet in kernel porting	
##############################################################
config PANTECH_SDXC_EXFAT
	bool	

endif
```

## arch/arm64/include/cust/LCD/Kconfig
```kconfig
if CUST_PANTECH_H

###################################################
# PANTECH LCD Feature Section                     #
#                                                 #
###################################################
# * Defined LCD common feature                    # 
###################################################
config MACH_MSM8937_LCD_COMMON
	bool
	default y
	#select F_SKYDISP_LCD_RESET
	#select F_SKYDISP_LCD_FORCE_ONOFF        
	#select F_SKYDISP_BACKLIGHT_DEBUG
	select F_SKYDISP_SILENT_BOOT
	#select F_SKYDISP_CMDS_CONTROL
	#select F_SKYDISP_BACKLIGHT_CMDS_CTL
	select F_SKYDISP_FACTORY_SLEEP_ENABLE
###################################################
# * Defined LCD board feature                     # 
###################################################
if MACH_MSM8937_EF71S
config DEFINE_LIST_EF71S
	bool
	default y
	select F_SKYDISP_EF71_SS
	select F_SKYDISP_CABC_CONTROL
	#select F_SKYDISP_SHARPNESS_CTRL
	select F_SKYDISP_BACKLIGHT_CMDS_CTL
endif

if MACH_MSM8937_EF71IE
config DEFINE_LIST_EF71IE
	bool
	default y
	select F_SKYDISP_EF71_SS
	select F_SKYDISP_CABC_CONTROL
	#select F_SKYDISP_SHARPNESS_CTRL
	select F_SKYDISP_BACKLIGHT_CMDS_CTL
endif

##############################################################
##############################################################
#               PANTECH  FEARTURE                            # 
#                                                            #
##############################################################
##############################################################      

##############################################################
# owner  : p14974          
# date    : 2014.12.24 
# PLM    : 
# Case  :       
# Description : EF78 model LCD common
##############################################################
config F_SKYDISP_EF71_SS
	bool

##############################################################
# owner  : p13832   seunghwa_ji       
# date    : 2013.04.11 
# PLM    : 
# Case  :       
# Description : it is for cabc control
##############################################################
config F_SKYDISP_CABC_CONTROL
	bool

##############################################################
# owner  : p13832 seunghwa_ji         
# date    : 2013.04.30
# PLM    : 
# Case  :       
# Description :  it's for silentboot
##############################################################
config F_SKYDISP_SILENT_BOOT
	bool

##############################################################
# owner  : p13447 shin jaegon    
# date    : 2013.05.02 
# PLM    : 
# Case  :       
# Description : Added codes for factory command ("FACTORY_SLEEP_ENABLE_I") 
##############################################################
config F_SKYDISP_FACTORY_SLEEP_ENABLE
	bool

##############################################################
# owner  : p10443          
# date    : 2013.06.27 
# PLM    : 
# Case  :       
# Description : EF56/EF59/EF60/61/62 sharpness control
##############################################################
config F_SKYDISP_SHARPNESS_CTRL
	bool

##############################################################
# owner  : p13832    
# date    : 2013.07.02 
# PLM    : 
# Case  :       
# Description : LCD cmds Test
##############################################################
config F_SKYDISP_CMDS_CONTROL
	bool

##############################################################
# owner  : p13832    
# date    : 2013.08.19 
# PLM    : 
# Case  :       
# Description : backlight on/off
##############################################################
config F_SKYDISP_BACKLIGHT_CMDS_CTL
	bool


##############################################################
##############################################################
#               QUALCOMM FEARTURE                 	         # 
#							                                 #
##############################################################
##############################################################

	
endif
```

## arch/arm64/include/cust/PMIC/Kconfig
```kconfig
if CUST_PANTECH_H
###################################################
#           PANTECH PMIC PART MODEL Feature       #
###################################################
config MACH_MSM8937_PMIC_COMMON
  bool
    default y
    select PANTECH_PMIC_RTC_ALM_OFF
    select PANTECH_PMIC_MONITOR_TEST
	select PANTECH_PMIC_JEITA_SW
	select PANTECH_PMIC_CHARGER_AUTO_PWR_ON
	select PANTECH_PMIC_NONSTANDARD_CHARGER
	select PANTECH_PMIC_CHARGER_WIRELESS
	select PANTECH_PMIC_SHARED_DATA
	select PANTECH_PMIC_HW_CHIP_REVISION
	select PANTECH_PMIC_CABLE_REMOVAL_WORKAROUND
	select PANTECH_PMIC_CHARGING_COUNT
	select PANTECH_PMIC_LCD_ICL
###################################################
#           PANTECH PMIC PART ALL Feature         #
###################################################

# this is used in rtc.h, rtc-dev.c, qpnp-rtc.c
config PANTECH_PMIC_RTC_ALM_OFF
    bool
    
# for test menu and pcdt.
config PANTECH_PMIC_MONITOR_TEST    
    bool
	
# SW JEITA control
config PANTECH_PMIC_JEITA_SW
	bool
	
# auto pwr on
config PANTECH_PMIC_CHARGER_AUTO_PWR_ON
	bool

# charging flow for abnormal charger.
config PANTECH_PMIC_NONSTANDARD_CHARGER
	bool
	
# Shared Memory
config PANTECH_PMIC_SHARED_DATA
	bool
	
# Wireless charging, Automatic Path Control
config PANTECH_PMIC_CHARGER_WIRELESS
	bool

# FACTORY_DEVICE_ID_I for pcdt tool. FEATURE_PANTECH_PMIC_HW_CHIP_REVISION
config PANTECH_PMIC_HW_CHIP_REVISION
	bool

# Wireless charging, fake cable insertion and removal
config PANTECH_PMIC_CABLE_REMOVAL_WORKAROUND
	bool

# Charging Count
config PANTECH_PMIC_CHARGING_COUNT
	bool

# Charging current limit by LCD on/off.
config PANTECH_PMIC_LCD_ICL
	bool
	
endif
```

## arch/arm64/include/cust/SIO/Kconfig
```kconfig
if CUST_PANTECH_H

###################################################
#           PANTECH USB part Feature              #
###################################################

config DEFINE_PANTECH_USB_COMMON
	bool
	default y
#	select HID_SONY
#	select HID_LOGITECH
#	select HID_SAMSUNG
	select ANDROID_PANTECH_USB_ABNORMAL_CHARGER_INFO
#	select PANTECH_SIO_TEMP
	select PANTECH_SIO_BUG_FIX
#	select PANTECH_USB_DEBUG
#	select PANTECH_USB_STATE_DEBUG
	select ANDROID_PANTECH_USB_OTG_INTENT
	select PANTECH_USB_TUNE_SIGNALING_PARAM

if MACH_MSM8937_EF71IE
config DEFINE_LIST_EF71IE
	bool
	default y
#	select PANTECH_USB_QXDM_ONOFF
	select PANTECH_USB_BUG_FIX
	select PANTECH_USB_OTG_EN_CONTROL
	select PANTECH_OTG_LOW_BATTERY
	select PANTECH_USB_CHARGER_WIRELESS
# add the feature

endif

if MACH_MSM8937_EF71S
config DEFINE_LIST_EF71S
	bool
	default y
	select PANTECH_USB_BUG_FIX
	select PANTECH_USB_OTG_EN_CONTROL
	select PANTECH_OTG_LOW_BATTERY
	select PANTECH_USB_BLOCKING_MDMSTATE
	select PANTECH_USB_CHARGER_WIRELESS
# add the feature

endif

if MACH_MSM8937_EF71K
config DEFINE_LIST_EF71K
	bool
	default y
	select PANTECH_USB_BUG_FIX
	select PANTECH_USB_OTG_EN_CONTROL
	select PANTECH_OTG_LOW_BATTERY
	select PANTECH_USB_BLOCKING_MDMSTATE
	select PANTECH_USB_CHARGER_WIRELESS
#add the feature
endif


comment "PANTECH USB Driver"

config PANTECH_CONSOLE_UART1
  bool

config PANTECH_CONSOLE_UART10
  bool
  
config ANDROID_PANTECH_USB
  bool "PANTECH USB"
  default y
	 help
     Support Pantech USB

config ANDROID_PANTECH_USB_MANAGER
  depends on ANDROID_PANTECH_USB
  bool "PANTECH USB Manager"
  default y
	  help
     Support Pantech USB Manager

config ANDROID_PANTECH_USB_CDFREE
  depends on ANDROID_PANTECH_USB
  bool "PANTECH USB Cdfree"
  default n
	 help
     Support Pantech USB Cdfree 

config ANDROID_PANTECH_USB_FACTORY_CABLE
  depends on ANDROID_PANTECH_USB
  bool "PANTECH USB FACTORY CABLE"
  default y
	 help
     Support Pantech USB

config ANDROID_PANTECH_USB_OTG
  bool "PANTECH USB OTG"
  default y
	 help
     Support Pantech USB OTG

config ANDROID_PANTECH_USB_OTG_INTENT
  depends on ANDROID_PANTECH_USB_OTG
  bool "PANTECH USB OTG Intent"
  default n
	 help
     Support Pantech USB OTG Intent

config PANTECH_USB_OTG_EN_CONTROL
  depends on ANDROID_PANTECH_USB_OTG
  bool "OTG_EN GPIO control "
  default n
	 help
     Support Pantech USB OTG Intent

config ANDROID_PANTECH_USB_ABNORMAL_CHARGER_INFO
 depends on ANDROID_PANTECH_USB
  bool "PANTECH USB Charger cable abnormal case"
  default n
	 help
     Support Pantech USB

config ANDROID_PANTECH_USB_SUPER_SPEED
  depends on ANDROID_PANTECH_USB
  bool "PANTECH USB SUPER SPEED DEVICE"
  default n

config PANTECH_SIO_BUG_FIX
  depends on ANDROID_PANTECH_USB
  bool "Debug feature for qualcomm bugs"
  default n

config PANTECH_USB_BUG_FIX
  bool "Pantech USB BSP bug fix"
  default n  
  
config PANTECH_SIO_TEMP
  depends on ANDROID_PANTECH_USB
  bool "Temporary feature for development"
  default n
  
config PANTECH_USB_DEBUG
  depends on ANDROID_PANTECH_USB
  bool "DWC3 core debug feature"
  default n

config PANTECH_USB_STATE_DEBUG
  depends on ANDROID_PANTECH_USB
  bool "DWC3 core debug feature"
  default n
 
config PANTECH_USB_BLOCKING_MDMSTATE
  depends on ANDROID_PANTECH_USB
  bool "Mobile device management code feature"
  default n

config PANTECH_USB_TUNE_SIGNALING_PARAM
  depends on ANDROID_PANTECH_USB
  bool "USB core line signaling tune feature"
  default n

config PANTECH_OTG_LOW_BATTERY
  depends on ANDROID_PANTECH_USB_OTG
  bool "OTG device electrical source manage for charger IC"
  default n

config PANTECH_USB_VER_SWITCH
  depends on ANDROID_PANTECH_USB
  bool "USB2 to USB3 dynamic change feature"
  default n
  
config PANTECH_USB_EXTERNAL_ID_PULLUP
  depends on ANDROID_PANTECH_USB
  bool "Use external USB_ID pull-up without internal USB_ID"
  default n
  
config PANTECH_USB_QXDM_ONOFF
  depends on ANDROID_PANTECH_USB
  bool "qxdm message on/off function"
  default n

config PANTECH_USB_CHARGER_WIRELESS
  depends on ANDROID_PANTECH_USB
  bool "Wireless charger feature"
  default n
endif
```

## arch/arm64/include/cust/SecureBoot/Kconfig
```kconfig
if CUST_PANTECH_H

###################################################
# PANTECH Secure Boot Section                     #
#                                                 #
config PANTECH_SECBOOT
  bool
  default n #PANTECH_SECBOOT

###################################################
# FEATURE_PANTECH_DXHDCP_PROVISIONING Section     #
#                                                 #
config PANTECH_DXHDCP_PROVISIONING
  bool
  default n #PANTECH_DXHDCP_PROVISIONING

endif
```

## drivers/switch/Kconfig
```kconfig
menuconfig SWITCH
	tristate "Switch class support"
	help
	  Say Y here to enable switch class support. This allows
	  monitoring switches by userspace via sysfs and uevent.

if SWITCH

config SWITCH_GPIO
	tristate "GPIO Swith support"
	depends on GPIOLIB
	help
	  Say Y here to enable GPIO based switch support.

config SWITCH_SKY
	tristate "SKY SWITCH DRIVER"
	depends on GPIOLIB
	default y
	help
	  Say Y here if you have a SKY_SWITCH o enable
	  support for the built-in SKY_SWITCH.

endif # SWITCH
```
