/*
 * Copyright (c) 2015, The Linux Foundation. All rights reserved.
 *
 * This program is free software; you can redistribute it and/or modify
 * it under the terms of the GNU General Public License version 2 and
 * only version 2 as published by the Free Software Foundation.
 *
 * This program is distributed in the hope that it will be useful,
 * but WITHOUT ANY WARRANTY; without even the implied warranty of
 * MERCHANTABILITY or FITNESS FOR A PARTICULAR PURPOSE.  See the
 * GNU General Public License for more details.
 */

/dts-v1/;

#include "msm8937.dtsi"
#include "msm8937-ef71ie.dtsi"
//#include "msm8937-ef71-ext-codec.dtsi" //FEATURE_PANTECH_SND
//#include "msm8937-audio-mtp.dtsi"  //FEATURE_PANTECH_SND  comment out 
#include "msm8937-gpio-keys-ef71-pt10.dtsi"
#include "msm8937-led-lp5523-ef71-pt10.dtsi"
#include "msm8937-camera-sensor-ef71ie_ws10.dtsi" //CONFIG_PANTECH_CAMERA
#include "msm8937-gpio-pmic-ef71-ws20.dtsi"
/ {
//	model = "Qualcomm Technologies, Inc. MSM8937-PMI8950 MTP";
	model = "Pantech, Inc. EF71IE from MSM8937-PMI8950 MTP";
	compatible = "qcom,msm8937-mtp", "qcom,msm8937", "qcom,mtp";
//	qcom,board-id= <8 0>;
	qcom,board-id= <103 0>;
	qcom,pmic-id = <0x10019 0x010011 0x0 0x0>;
};
