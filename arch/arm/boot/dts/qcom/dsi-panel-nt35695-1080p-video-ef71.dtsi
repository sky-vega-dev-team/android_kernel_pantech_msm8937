/* Copyright (c) 2013, The Linux Foundation. All rights reserved.
 *
 * This program is free software; you can redistribute it and/or modify
 * it under the terms of the GNU General Public License version 2 and
 * only version 2 as published by the Free Software Foundation.
 *
 * This program is distributed in the hope that it will be useful,
 * but WITHOUT ANY WARRANTY; without even the implied warranty of
 * MERCHANTABILITY or FITNESS FOR A PARTICULAR PURPOSE.  See the
 * GNU General Public License for more details.
 */

/*---------------------------------------------------------------------------
 * This file is autogenerated file using gcdb parser. Please do not edit it.
 * Update input XML file to add a new entry or update variable in this file
 * VERSION = "1.0"
 *---------------------------------------------------------------------------*/

&mdss_mdp {
	dsi_nt35695_1080p_video_ef71: qcom,mdss_dsi_nt35695_1080p_video_ef71 {
		qcom,mdss-dsi-panel-name = "nt35695 1080p video mode dsi panel";
		qcom,mdss-dsi-panel-controller = <&mdss_dsi0>;
		qcom,mdss-dsi-panel-type = "dsi_video_mode";
		qcom,mdss-dsi-panel-destination = "display_1";
		qcom,mdss-dsi-panel-framerate = <60>;
		qcom,mdss-dsi-virtual-channel-id = <0>;
		qcom,mdss-dsi-stream = <0>;
		qcom,mdss-dsi-panel-width = <1080>;
		qcom,mdss-dsi-panel-height = <1920>;
		qcom,mdss-dsi-h-front-porch = <180>;
		qcom,mdss-dsi-h-back-porch = <142>;		
		qcom,mdss-dsi-h-pulse-width = <10>;
		qcom,mdss-dsi-h-sync-skew = <0>;
		qcom,mdss-dsi-v-back-porch = <4>;
		qcom,mdss-dsi-v-front-porch = <10>;
		qcom,mdss-dsi-v-pulse-width = <2>;
		qcom,mdss-dsi-h-left-border = <0>;
		qcom,mdss-dsi-h-right-border = <0>;
		qcom,mdss-dsi-v-top-border = <0>;
		qcom,mdss-dsi-v-bottom-border = <0>;
		qcom,mdss-dsi-bpp = <24>;
		qcom,mdss-dsi-underflow-color = <0xff>;
		qcom,mdss-dsi-border-color = <0>;	

		qcom,mdss-dsi-on-command = [15 01 00 00 00 00 02 FF 10
		                     15 01 00 00 00 00 02 FB 01
		                     15 01 00 00 00 00 02 BA 03
		                     15 01 00 00 00 00 02 35 00
		                     15 01 00 00 00 00 02 BB 03
		                     15 01 00 00 00 00 02 B0 03
				     39 01 00 00 00 00 06 3B 03 06 0A 98 B4
				     15 01 00 00 00 00 02 FF 10  //cabc
				     15 01 00 00 00 00 02 55 01
				     15 01 00 00 00 00 02 FF 23
				     15 01 00 00 00 00 02 01 84
				     15 01 00 00 00 00 02 08 04  //pwm 
				     15 01 00 00 00 00 02 46 45
				     15 01 00 00 00 00 02 FF 10
				     05 01 00 00 78 00 01 11
				     15 01 00 00 00 00 02 51 FF
				     15 01 00 00 00 00 02 53 24
				     15 01 00 00 00 00 02 FF 10					
				     05 01 00 00 30 00 01 29];
	
		qcom,mdss-dsi-off-command = [05 01 00 00 96 00 02 28 00
					05 01 00 00 96 00 02 10 00]; //wait time 32,78 ->96,96	
		qcom,mdss-dsi-cabc-command = [15 01 00 00 00 00 02 FF 10
					15 01 00 00 00 00 02 55 01];			
		qcom,mdss-dsi-on-command-state = "dsi_lp_mode";
		qcom,mdss-dsi-off-command-state = "dsi_hs_mode";
		qcom,mdss-dsi-h-sync-pulse = <0>;
		qcom,mdss-dsi-traffic-mode = "non_burst_sync_event";
		qcom,mdss-dsi-bllp-eof-power-mode;
		qcom,mdss-dsi-bllp-power-mode;
		qcom,mdss-dsi-lane-0-state;
		qcom,mdss-dsi-lane-1-state;
		qcom,mdss-dsi-lane-2-state;
		qcom,mdss-dsi-lane-3-state;
		
		//qcom,mdss-dsi-panel-timings = [E2 36 24 00 66 6A 2A 3A 6A 04 05 00];//870MHZ, 8
		//qcom,mdss-dsi-t-clk-post = <0x1C>; //870MHZ, 8
		//qcom,mdss-dsi-t-clk-pre = <0x31>; //870MHZ, 8
		//qcom,mdss-dsi-panel-timings = [FB 3E 2A 00 70 74 2E 42 33 03 04 00]; // escclk - 19.2
		//qcom,mdss-dsi-t-clk-post = <0x02>;
		//qcom,mdss-dsi-t-clk-pre = <0x2E>;		

                //984/19.2 (G excel) change (T_TA_GO: Min. 4TLPX, T_TA_GET: Min 5TLPX, T_CLK_POST: Min. 377ns)
                qcom,mdss-dsi-panel-timings = [FB 3E 2A 00 70 74 2E 42 33 04 05 00]; 
                qcom,mdss-dsi-t-clk-post = <0x21>; 
                qcom,mdss-dsi-t-clk-pre = <0x2E>; 



		qcom,mdss-dsi-bl-min-level = <1>;
		qcom,mdss-dsi-bl-max-level = <216>;
		//qcom,mdss-dsi-bl-max-level = <2048>;//Parksungho, Reduce 40ms to 20ms by changing 4095 to 2048 in WLED
		qcom,mdss-dsi-dma-trigger = "trigger_sw";
		qcom,mdss-dsi-mdp-trigger = "none";
		qcom,mdss-dsi-bl-pmic-control-type = "bl_ctrl_dcs";
		//qcom,mdss-dsi-bl-pmic-control-type = "bl_ctrl_wled"; //Parksungho, for WLED
		qcom,mdss-dsi-reset-sequence = <1 20>, <0 1>, <1 20>;

	};
};

