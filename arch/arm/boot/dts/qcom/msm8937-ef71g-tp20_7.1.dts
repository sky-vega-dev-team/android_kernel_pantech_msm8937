/*
 * Copyright (c) 2015, The Linux Foundation. All rights reserved.
 *
 * This program is free software; you can redistribute it and/or modify
 * it under the terms of the GNU General Public License version 2 and
 * only version 2 as published by the Free Software Foundation.
 *
 * This program is distributed in the hope that it will be useful,
 * but WITHOUT ANY WARRANTY; without even the implied warranty of
 * MERCHANTABILITY or FITNESS FOR A PARTICULAR PURPOSE.  See the
 * GNU General Public License for more details.
 */

/dts-v1/;

#include "msm8937.dtsi"
#include "msm8937-ef71g.dtsi"
#include "msm8937-gpio-keys-ef71-ws20.dtsi"
#include "msm8937-led-lp5523-ef71-ws20.dtsi"
#include "msm8937-camera-sensor-ef71ie_tp20.dtsi"
#include "msm8937-gpio-pmic-ef71-tp10.dtsi"
#include "msm8937-ef71-tp20_7.1.dtsi"
