/* Copyright (c) 2013-2014, The Linux Foundation. All rights reserved.
 *
 * This program is free software; you can redistribute it and/or modify
 * it under the terms of the GNU General Public License version 2 and
 * only version 2 as published by the Free Software Foundation.
 *
 * This program is distributed in the hope that it will be useful,
 * but WITHOUT ANY WARRANTY; without even the implied warranty of
 * MERCHANTABILITY or FITNESS FOR A PARTICULAR PURPOSE.  See the
 * GNU General Public License for more details.
 */

&mdss_mdp {
	dsi_nt35531_1080p_cmd_ef78: qcom,mdss_dsi_nt35531_1080p_cmd_ef78 {
		qcom,mdss-dsi-panel-name = "nt35531 1080p command mode dsi panel";
		qcom,mdss-dsi-panel-controller = <&mdss_dsi0>;
		qcom,mdss-dsi-panel-type = "dsi_cmd_mode";
		qcom,mdss-dsi-panel-destination = "display_1";
		qcom,mdss-dsi-panel-framerate = <60>;
		qcom,mdss-dsi-virtual-channel-id = <0>;
		qcom,mdss-dsi-stream = <0>;
		qcom,mdss-dsi-panel-width = <1080>;
		qcom,mdss-dsi-panel-height = <1920>;
		qcom,mdss-dsi-h-front-porch = <131>;
		qcom,mdss-dsi-h-back-porch = <24>;
		qcom,mdss-dsi-h-pulse-width = <6>;
		qcom,mdss-dsi-h-sync-skew = <0>;
		qcom,mdss-dsi-v-back-porch = <7>;
		qcom,mdss-dsi-v-front-porch = <13>;
		qcom,mdss-dsi-v-pulse-width = <2>;
		qcom,mdss-dsi-h-left-border = <0>;
		qcom,mdss-dsi-h-right-border = <0>;
		qcom,mdss-dsi-v-top-border = <0>;
		qcom,mdss-dsi-v-bottom-border = <0>;
		qcom,mdss-dsi-bpp = <24>;
		qcom,mdss-dsi-underflow-color = <0xff>;
		qcom,mdss-dsi-border-color = <0>;	
/* 60hz refresh rate */
/*		
		qcom,mdss-dsi-on-command = [15 01 00 00 00 00 02 FF 10
					39 01 00 00 00 00 06 3B 03 09 0D 1E 83
					15 01 00 00 00 00 02 B0 00
					15 01 00 00 00 00 02 BB 10
					15 01 00 00 00 00 02 D9 00
					15 01 00 00 00 00 02 E5 00
					15 01 00 00 00 00 02 FF E0
					15 01 00 00 00 00 02 FB 01
					15 01 00 00 00 00 02 1F 70
					15 01 00 00 00 00 02 9E 03
					15 01 00 00 00 00 02 FF 10
					15 01 00 00 00 00 02 35 00
					15 01 00 00 00 00 02 51 80
					15 01 00 00 00 00 02 53 24
					15 01 00 00 00 00 02 55 03
					05 01 00 00 60 00 01 11
					05 01 00 00 78 00 01 29];
*/			
/* 30hz refresh rate */
		qcom,mdss-dsi-on-command = [15 01 00 00 00 00 02 FF 10
					39 01 00 00 00 00 06 3B 03 09 0D 1E 83
					15 01 00 00 00 00 02 B0 08
					15 01 00 00 00 00 02 BB 10
					15 01 00 00 00 00 02 D9 00
					15 01 00 00 00 00 02 E5 00
					15 01 00 00 00 00 02 FF 26
					15 01 00 00 00 00 02 FB 01
					15 01 00 00 00 00 02 21 00
					15 01 00 00 00 00 02 1D 00
					15 01 00 00 00 00 02 FF E0
					15 01 00 00 00 00 02 FB 01
					15 01 00 00 00 00 02 1F 70
					15 01 00 00 00 00 02 9E 03
					15 01 00 00 00 00 02 FF 10
					15 01 00 00 00 00 02 35 00
					15 01 00 00 00 00 02 51 80
					15 01 00 00 00 00 02 53 24
					15 01 00 00 00 00 02 55 03
					05 01 00 00 60 00 01 11
					05 01 00 00 78 00 01 29];
					
		qcom,mdss-dsi-off-command = [05 01 00 00 32 00 02 28 00
					05 01 00 00 78 00 02 10 00];	
		qcom,mdss-dsi-cabc-command = [15 01 00 00 00 00 02 FF 10
					15 01 00 00 00 00 02 55 03];					
		qcom,mdss-dsi-on-command-state = "dsi_lp_mode";
		qcom,mdss-dsi-off-command-state = "dsi_hs_mode";		
		qcom,mdss-dsi-cabc-command-state = "dsi_hs_mode";

/*		qcom,mdss-dsi-panel-status-check-mode = "bta_check";*/
		qcom,mdss-dsi-h-sync-pulse = <1>;
		qcom,mdss-dsi-traffic-mode = "burst_mode";
		qcom,mdss-dsi-bllp-eof-power-mode;
		qcom,mdss-dsi-bllp-power-mode;
		qcom,mdss-dsi-lane-0-state;
		qcom,mdss-dsi-lane-1-state;
		qcom,mdss-dsi-lane-2-state;
		qcom,mdss-dsi-lane-3-state;
		qcom,mdss-dsi-wr-mem-start = <0x2c>;
		qcom,mdss-dsi-te-pin-select = <1>;
		qcom,mdss-dsi-te-dcs-command = <1>;
		qcom,mdss-dsi-te-check-enable;
		qcom,mdss-dsi-te-using-te-pin;
		qcom,mdss-dsi-panel-timings = [E7 36 24 00 66 6A 2A 3A 2D 03 04 00];
		qcom,mdss-dsi-t-clk-post = <0x03>;
		qcom,mdss-dsi-t-clk-pre = <0x2B>;
		qcom,mdss-dsi-bl-min-level = <1>;
		qcom,mdss-dsi-bl-max-level = <216>;
		qcom,mdss-dsi-dma-trigger = "trigger_sw";
		qcom,mdss-dsi-mdp-trigger = "none";
		qcom,mdss-dsi-bl-pmic-control-type = "bl_ctrl_dcs";
		qcom,mdss-dsi-reset-sequence = <1 20>, <0 1>, <1 20>;
		qcom,mdss-pan-physical-width-dimension = <59>;
		qcom,mdss-pan-physical-height-dimension = <104>;
/*		
		qcom,partial-update-enabled;
		qcom,panel-roi-alignment = <2 2 2 2 0 0>;
*/
	};
};
