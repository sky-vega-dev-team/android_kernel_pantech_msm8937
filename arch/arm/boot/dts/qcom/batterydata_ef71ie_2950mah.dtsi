
qcom,2307112_pantech_ef71ie_2950mah_averaged_masterslave_feb2nd2016 {
	/* #2307112_Pantech_EF71IE_2950mAh_averaged_MasterSlave_Feb2nd2016*/
	qcom,max-voltage-uv = <4400000>;
	qcom,nom-batt-capacity-mah = <2950>;
	qcom,batt-id-kohm = <100>;
	qcom,battery-beta = <3435>;
	qcom,battery-type = "2307112_pantech_ef71ie_2950mah_averaged_masterslave_feb2nd2016";
	qcom,chg-rslow-comp-c1 = <3674601>;
	qcom,chg-rslow-comp-c2 = <5777658>;
	qcom,chg-rs-to-rslow = <995490>;
	qcom,chg-rslow-comp-thr = <0xAE>;
	qcom,checksum = <0x8363>;
	qcom,gui-version = "PMI8950GUI - 2.0.0.15";
	qcom,fg-profile-data = [
		 E0 83 C0 7C 
		 EB 80 C9 76 
		 5C 83 32 6C 
		 31 88 65 8F 
		 72 82 09 98 
		 E6 B5 C4 C1 
		 52 16 EE 83 
		 B6 7C BA 80 
		 2E 76 4C 83 
		 C7 71 EC 6E 
		 3C 77 52 82 
		 A5 99 F0 BC 
		 D2 C9 58 0D 
		 DF 0B 70 5B 
		 14 70 71 FD 
		 83 13 C7 44 
		 FE 22 00 00 
		 7A 46 15 24 
		 8E 3A 00 00 
		 00 00 00 00 
		 00 00 00 00 
		 12 6B E9 69 
		 7E 69 EF 83 
		 4B 74 EC 62 
		 B0 68 4C 81 
		 A0 6E 33 60 
		 2E 6E 87 AB 
		 18 CD 63 4B 
		 65 A0 71 0C 
		 28 00 FF 36 
		 F0 11 30 03 
		 00 00 00 0C 
	];
};
