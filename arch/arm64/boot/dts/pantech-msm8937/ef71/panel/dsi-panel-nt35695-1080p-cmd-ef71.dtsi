/* Copyright (c) 2013-2014, The Linux Foundation. All rights reserved.
 *
 * This program is free software; you can redistribute it and/or modify
 * it under the terms of the GNU General Public License version 2 and
 * only version 2 as published by the Free Software Foundation.
 *
 * This program is distributed in the hope that it will be useful,
 * but WITHOUT ANY WARRANTY; without even the implied warranty of
 * MERCHANTABILITY or FITNESS FOR A PARTICULAR PURPOSE.  See the
 * GNU General Public License for more details.
 */

&mdss_mdp {
	dsi_nt35695_1080p_cmd_ef71: qcom,mdss_dsi_nt35695_1080p_cmd_ef71 {
		qcom,mdss-dsi-panel-name = "nt35695 1080p command mode dsi panel";
		qcom,mdss-dsi-panel-controller = <&mdss_dsi0>;
		qcom,mdss-dsi-panel-type = "dsi_cmd_mode";
		qcom,mdss-dsi-panel-destination = "display_1";
		qcom,mdss-dsi-panel-framerate = <60>;
		qcom,mdss-dsi-virtual-channel-id = <0>;
		qcom,mdss-dsi-stream = <0>;
		qcom,mdss-dsi-panel-width = <1080>;
		qcom,mdss-dsi-panel-height = <1920>;
		qcom,mdss-dsi-h-front-porch = <180>;
		qcom,mdss-dsi-h-back-porch = <142>;
		qcom,mdss-dsi-h-pulse-width = <10>;
		qcom,mdss-dsi-h-sync-skew = <0>;
		qcom,mdss-dsi-v-back-porch = <4>;
		qcom,mdss-dsi-v-front-porch = <10>;
		qcom,mdss-dsi-v-pulse-width = <2>;
		qcom,mdss-dsi-h-left-border = <0>;
		qcom,mdss-dsi-h-right-border = <0>;
		qcom,mdss-dsi-v-top-border = <0>;
		qcom,mdss-dsi-v-bottom-border = <0>;
		qcom,mdss-dsi-bpp = <24>;
		qcom,mdss-dsi-underflow-color = <0xff>;
		qcom,mdss-dsi-border-color = <0>;	
	
/* 60hz refresh rate */
		qcom,mdss-dsi-on-command = [15 01 00 00 00 00 02 FF 10
			15 01 00 00 00 00 02 FB 01
			15 01 00 00 00 00 02 BA 03
			15 01 00 00 00 00 02 35 00
			15 01 00 00 00 00 02 44 03
			15 01 00 00 00 00 02 BB 10
			15 01 00 00 00 00 02 B0 03
			15 01 00 00 00 00 02 FF 10 
 			//15 01 00 00 00 00 02 51 5C // backlight level 216
			15 01 00 00 00 00 02 55 01
			15 01 00 00 00 00 02 FF 23  //cabc
			15 01 00 00 00 00 02 01 84

			15 01 00 00 00 00 02 FB 01
			15 01 00 00 00 00 02 08 02  //pwm 40KHz
			15 01 00 00 00 00 02 46 45
			15 01 00 00 00 00 02 FF 10
			05 01 00 00 6e 00 02 11 00 //wait min 100
			15 01 00 00 00 00 02 53 24
			15 01 00 00 00 00 02 FF 10
			05 01 00 00 30 00 01 29];
					
		qcom,mdss-dsi-off-command = [05 01 00 00 96 00 02 28 00
					05 01 00 00 96 00 02 10 00]; //wait time 32,78 ->96,96
		qcom,mdss-dsi-cabc-command = [15 01 00 00 00 00 02 FF 10
					15 01 00 00 00 00 02 55 01];					
		qcom,mdss-dsi-on-command-state = "dsi_lp_mode";
		qcom,mdss-dsi-off-command-state = "dsi_hs_mode";		
		qcom,mdss-dsi-cabc-command-state = "dsi_hs_mode";

                qcom,mdss-dsi-gamma20-command = [15 01 00 00 00 00 02 FF 20 //page
						15 01 00 00 00 00 02 75 00 //red positive
						15 01 00 00 00 00 02 76 1D
						15 01 00 00 00 00 02 77 00
						15 01 00 00 00 00 02 78 37
						15 01 00 00 00 00 02 79 00
						15 01 00 00 00 00 02 7A 60
						15 01 00 00 00 00 02 7B 00
						15 01 00 00 00 00 02 7C 82
						15 01 00 00 00 00 02 7D 00
						15 01 00 00 00 00 02 7E 9D
						15 01 00 00 00 00 02 7F 00
						15 01 00 00 00 00 02 80 B4
						15 01 00 00 00 00 02 81 00
						15 01 00 00 00 00 02 82 C8
						15 01 00 00 00 00 02 83 00
						15 01 00 00 00 00 02 84 D9
						15 01 00 00 00 00 02 85 00
						15 01 00 00 00 00 02 86 E9
						15 01 00 00 00 00 02 87 01
						15 01 00 00 00 00 02 88 1A
						15 01 00 00 00 00 02 89 01
						15 01 00 00 00 00 02 8A 44
						15 01 00 00 00 00 02 8B 01
						15 01 00 00 00 00 02 8C 7F
						15 01 00 00 00 00 02 8D 01
						15 01 00 00 00 00 02 8E AB
						15 01 00 00 00 00 02 8F 01
						15 01 00 00 00 00 02 90 EE
						15 01 00 00 00 00 02 91 02
						15 01 00 00 00 00 02 92 23
						15 01 00 00 00 00 02 93 02
						15 01 00 00 00 00 02 94 24
						15 01 00 00 00 00 02 95 02
						15 01 00 00 00 00 02 96 57
						15 01 00 00 00 00 02 97 02
						15 01 00 00 00 00 02 98 97
						15 01 00 00 00 00 02 99 02
						15 01 00 00 00 00 02 9A C1
						15 01 00 00 00 00 02 9B 02
						15 01 00 00 00 00 02 9C F7
						15 01 00 00 00 00 02 9D 03
						15 01 00 00 00 00 02 9E 17
						15 01 00 00 00 00 02 9F 03
						15 01 00 00 00 00 02 A0 41
						15 01 00 00 00 00 02 A2 03
						15 01 00 00 00 00 02 A3 4D
						15 01 00 00 00 00 02 A4 03
						15 01 00 00 00 00 02 A5 5A
						15 01 00 00 00 00 02 A6 03
						15 01 00 00 00 00 02 A7 69
						15 01 00 00 00 00 02 A9 03
						15 01 00 00 00 00 02 AA 7B
						15 01 00 00 00 00 02 AB 03
						15 01 00 00 00 00 02 AC 90
						15 01 00 00 00 00 02 AD 03
						15 01 00 00 00 00 02 AE AA
						15 01 00 00 00 00 02 AF 03
						15 01 00 00 00 00 02 B0 CB
						15 01 00 00 00 00 02 B1 03
						15 01 00 00 00 00 02 B2 D8
						15 01 00 00 00 00 02 B3 00 //red nagative
						15 01 00 00 00 00 02 B4 57
						15 01 00 00 00 00 02 B5 00
						15 01 00 00 00 00 02 B6 72
						15 01 00 00 00 00 02 B7 00
						15 01 00 00 00 00 02 B8 9B
						15 01 00 00 00 00 02 B9 00
						15 01 00 00 00 00 02 BA BC
						15 01 00 00 00 00 02 BB 00
						15 01 00 00 00 00 02 BC D7
						15 01 00 00 00 00 02 BD 00
						15 01 00 00 00 00 02 BE EE
						15 01 00 00 00 00 02 BF 01
						15 01 00 00 00 00 02 C0 02
						15 01 00 00 00 00 02 C1 01
						15 01 00 00 00 00 02 C2 14
						15 01 00 00 00 00 02 C3 01
						15 01 00 00 00 00 02 C4 24
						15 01 00 00 00 00 02 C5 01
						15 01 00 00 00 00 02 C6 54
						15 01 00 00 00 00 02 C7 01
						15 01 00 00 00 00 02 C8 7E
						15 01 00 00 00 00 02 C9 01
						15 01 00 00 00 00 02 CA BA
						15 01 00 00 00 00 02 CB 01
						15 01 00 00 00 00 02 CC E6
						15 01 00 00 00 00 02 CD 02
						15 01 00 00 00 00 02 CE 29
						15 01 00 00 00 00 02 CF 02
						15 01 00 00 00 00 02 D0 5E
						15 01 00 00 00 00 02 D1 02
						15 01 00 00 00 00 02 D2 5F
						15 01 00 00 00 00 02 D3 02
						15 01 00 00 00 00 02 D4 92
						15 01 00 00 00 00 02 D5 02
						15 01 00 00 00 00 02 D6 C3
						15 01 00 00 00 00 02 D7 02
						15 01 00 00 00 00 02 D8 E0
						15 01 00 00 00 00 02 D9 03
						15 01 00 00 00 00 02 DA 04
						15 01 00 00 00 00 02 DB 03
						15 01 00 00 00 00 02 DC 1E
						15 01 00 00 00 00 02 DD 03
						15 01 00 00 00 00 02 DE 45
						15 01 00 00 00 00 02 DF 03
						15 01 00 00 00 00 02 E0 50
						15 01 00 00 00 00 02 E1 03
						15 01 00 00 00 00 02 E2 5D
						15 01 00 00 00 00 02 E3 03
						15 01 00 00 00 00 02 E4 6C
						15 01 00 00 00 00 02 E5 03
						15 01 00 00 00 00 02 E6 7D
						15 01 00 00 00 00 02 E7 03
						15 01 00 00 00 00 02 E8 91
						15 01 00 00 00 00 02 E9 03
						15 01 00 00 00 00 02 EA AB
						15 01 00 00 00 00 02 EB 03
						15 01 00 00 00 00 02 EC CC
						15 01 00 00 00 00 02 ED 03
						15 01 00 00 00 00 02 EE D8
						15 01 00 00 00 00 02 EF	00 //green positive
						15 01 00 00 00 00 02 F0	AE
						15 01 00 00 00 00 02 F1	00
						15 01 00 00 00 00 02 F2	B8
						15 01 00 00 00 00 02 F3	00
						15 01 00 00 00 00 02 F4	CB
						15 01 00 00 00 00 02 F5	00
						15 01 00 00 00 00 02 F6	DD
						15 01 00 00 00 00 02 F7	00
						15 01 00 00 00 00 02 F8	EC
						15 01 00 00 00 00 02 F9	00
						15 01 00 00 00 00 02 FA	FB
						15 01 00 00 00 00 02 FF	21 //page change
						15 01 00 00 00 00 02 00	01 //green positive continues
						15 01 00 00 00 00 02 01	08
						15 01 00 00 00 00 02 02	01
						15 01 00 00 00 00 02 03	13
						15 01 00 00 00 00 02 04	01
						15 01 00 00 00 00 02 05	1F
						15 01 00 00 00 00 02 06	01
						15 01 00 00 00 00 02 07	43
						15 01 00 00 00 00 02 08	01
						15 01 00 00 00 00 02 09	63
						15 01 00 00 00 00 02 0A	01
						15 01 00 00 00 00 02 0B	93
						15 01 00 00 00 00 02 0C	01
						15 01 00 00 00 00 02 0D B8
						15 01 00 00 00 00 02 0E	01
						15 01 00 00 00 00 02 0F	F4
						15 01 00 00 00 00 02 10	02
						15 01 00 00 00 00 02 11	26
						15 01 00 00 00 00 02 12	02
						15 01 00 00 00 00 02 13	28
						15 01 00 00 00 00 02 14	02
						15 01 00 00 00 00 02 15	59
						15 01 00 00 00 00 02 16	02
						15 01 00 00 00 00 02 17	99
						15 01 00 00 00 00 02 18	02
						15 01 00 00 00 00 02 19	C2
						15 01 00 00 00 00 02 1A	02
						15 01 00 00 00 00 02 1B	F8
						15 01 00 00 00 00 02 1C	03
						15 01 00 00 00 00 02 1D	18
						15 01 00 00 00 00 02 1E	03
						15 01 00 00 00 00 02 1F	41
						15 01 00 00 00 00 02 20	03
						15 01 00 00 00 00 02 21	4C
						15 01 00 00 00 00 02 22	03
						15 01 00 00 00 00 02 23	59
						15 01 00 00 00 00 02 24	03
						15 01 00 00 00 00 02 25	68
						15 01 00 00 00 00 02 26	03
						15 01 00 00 00 00 02 27	7A
						15 01 00 00 00 00 02 28	03
						15 01 00 00 00 00 02 29	8D
						15 01 00 00 00 00 02 2A	03
						15 01 00 00 00 00 02 2B	A9
						15 01 00 00 00 00 02 2D	03
						15 01 00 00 00 00 02 2F	CB
						15 01 00 00 00 00 02 30	03
						15 01 00 00 00 00 02 31	D8
						15 01 00 00 00 00 02 32	00 //green negative
						15 01 00 00 00 00 02 33	D2
						15 01 00 00 00 00 02 34	00
						15 01 00 00 00 00 02 35	DC
						15 01 00 00 00 00 02 36	00
						15 01 00 00 00 00 02 37	F0
						15 01 00 00 00 00 02 38	01
						15 01 00 00 00 00 02 39	02
						15 01 00 00 00 00 02 3A	01
						15 01 00 00 00 00 02 3B	13
						15 01 00 00 00 00 02 3D	01
						15 01 00 00 00 00 02 3F	22
						15 01 00 00 00 00 02 40	01
						15 01 00 00 00 00 02 41	2F
						15 01 00 00 00 00 02 42	01
						15 01 00 00 00 00 02 43	3B
						15 01 00 00 00 00 02 44	01
						15 01 00 00 00 00 02 45	47
						15 01 00 00 00 00 02 46	01
						15 01 00 00 00 00 02 47	6D
						15 01 00 00 00 00 02 48	01
						15 01 00 00 00 00 02 49	8F
						15 01 00 00 00 00 02 4A	01
						15 01 00 00 00 00 02 4B	C3
						15 01 00 00 00 00 02 4C	01
						15 01 00 00 00 00 02 4D	EC
						15 01 00 00 00 00 02 4E	02
						15 01 00 00 00 00 02 4F	2E
						15 01 00 00 00 00 02 50	02
						15 01 00 00 00 00 02 51	61
						15 01 00 00 00 00 02 52	02
						15 01 00 00 00 00 02 53	63
						15 01 00 00 00 00 02 54	02
						15 01 00 00 00 00 02 55	94
						15 01 00 00 00 00 02 56	02
						15 01 00 00 00 00 02 58	C5
						15 01 00 00 00 00 02 59	02
						15 01 00 00 00 00 02 5A	E0
						15 01 00 00 00 00 02 5B	03
						15 01 00 00 00 00 02 5C	06
						15 01 00 00 00 00 02 5D	03
						15 01 00 00 00 00 02 5E	1F
						15 01 00 00 00 00 02 5F	03
						15 01 00 00 00 00 02 60	45
						15 01 00 00 00 00 02 61	03
						15 01 00 00 00 00 02 62	50
						15 01 00 00 00 00 02 63	03
						15 01 00 00 00 00 02 64	5C
						15 01 00 00 00 00 02 65	03
						15 01 00 00 00 00 02 66	6B
						15 01 00 00 00 00 02 67	03
						15 01 00 00 00 00 02 68	7C
						15 01 00 00 00 00 02 69	03
						15 01 00 00 00 00 02 6A	8F
						15 01 00 00 00 00 02 6B	03
						15 01 00 00 00 00 02 6C	AA
						15 01 00 00 00 00 02 6D	03
						15 01 00 00 00 00 02 6E	CB
						15 01 00 00 00 00 02 6F	03
						15 01 00 00 00 00 02 70	D8
						15 01 00 00 00 00 02 71	00 //blue positive
						15 01 00 00 00 00 02 72	F4
						15 01 00 00 00 00 02 73	00
						15 01 00 00 00 00 02 74	FB
						15 01 00 00 00 00 02 75	01
						15 01 00 00 00 00 02 76	08
						15 01 00 00 00 00 02 77	01
						15 01 00 00 00 00 02 78	14
						15 01 00 00 00 00 02 79	01
						15 01 00 00 00 00 02 7A	1F
						15 01 00 00 00 00 02 7B	01
						15 01 00 00 00 00 02 7C	2A
						15 01 00 00 00 00 02 7D	01
						15 01 00 00 00 00 02 7E	35
						15 01 00 00 00 00 02 7F	01
						15 01 00 00 00 00 02 80	42
						15 01 00 00 00 00 02 81	01
						15 01 00 00 00 00 02 82	4C
						15 01 00 00 00 00 02 83	01
						15 01 00 00 00 00 02 84	63
						15 01 00 00 00 00 02 85	01
						15 01 00 00 00 00 02 86	7E
						15 01 00 00 00 00 02 87	01
						15 01 00 00 00 00 02 88	A7
						15 01 00 00 00 00 02 89	01
						15 01 00 00 00 00 02 8A	C8
						15 01 00 00 00 00 02 8B	01
						15 01 00 00 00 00 02 8C	FD
						15 01 00 00 00 00 02 8D	02
						15 01 00 00 00 00 02 8E	2E
						15 01 00 00 00 00 02 8F	02
						15 01 00 00 00 00 02 90	2F
						15 01 00 00 00 00 02 91	02
						15 01 00 00 00 00 02 92	60
						15 01 00 00 00 00 02 93	02
						15 01 00 00 00 00 02 94	A0
						15 01 00 00 00 00 02 95	02
						15 01 00 00 00 00 02 96	C8
						15 01 00 00 00 00 02 97	02
						15 01 00 00 00 00 02 98	FF
						15 01 00 00 00 00 02 99	03
						15 01 00 00 00 00 02 9A	1F
						15 01 00 00 00 00 02 9B	03
						15 01 00 00 00 00 02 9C	47
						15 01 00 00 00 00 02 9D	03
						15 01 00 00 00 00 02 9E	53
						15 01 00 00 00 00 02 9F	03
						15 01 00 00 00 00 02 A0	60
						15 01 00 00 00 00 02 A2	03
						15 01 00 00 00 00 02 A3	6E
						15 01 00 00 00 00 02 A4	03
						15 01 00 00 00 00 02 A5	80
						15 01 00 00 00 00 02 A6	03
						15 01 00 00 00 00 02 A7	93
						15 01 00 00 00 00 02 A9	03
						15 01 00 00 00 00 02 AA	AE
						15 01 00 00 00 00 02 AB	03
						15 01 00 00 00 00 02 AC	CD
						15 01 00 00 00 00 02 AD	03
						15 01 00 00 00 00 02 AE	D8
						15 01 00 00 00 00 02 AF	01 //blue negative
						15 01 00 00 00 00 02 B0	0D
						15 01 00 00 00 00 02 B1	01
						15 01 00 00 00 00 02 B2	15
						15 01 00 00 00 00 02 B3	01
						15 01 00 00 00 00 02 B4	23
						15 01 00 00 00 00 02 B5	01
						15 01 00 00 00 00 02 B6	2F
						15 01 00 00 00 00 02 B7	01
						15 01 00 00 00 00 02 B8	3B
						15 01 00 00 00 00 02 B9	01
						15 01 00 00 00 00 02 BA	47
						15 01 00 00 00 00 02 BB	01
						15 01 00 00 00 00 02 BC	53
						15 01 00 00 00 00 02 BD	01
						15 01 00 00 00 00 02 BE	60
						15 01 00 00 00 00 02 BF	01
						15 01 00 00 00 00 02 C0	6B
						15 01 00 00 00 00 02 C1	01
						15 01 00 00 00 00 02 C2	85
						15 01 00 00 00 00 02 C3	01
						15 01 00 00 00 00 02 C4	A3
						15 01 00 00 00 00 02 C5	01
						15 01 00 00 00 00 02 C6	D3
						15 01 00 00 00 00 02 C7	01
						15 01 00 00 00 00 02 C8	F9
						15 01 00 00 00 00 02 C9	02
						15 01 00 00 00 00 02 CA	36
						15 01 00 00 00 00 02 CB	02
						15 01 00 00 00 00 02 CC	69
						15 01 00 00 00 00 02 CD	02
						15 01 00 00 00 00 02 CE	6A
						15 01 00 00 00 00 02 CF	02
						15 01 00 00 00 00 02 D0	9B
						15 01 00 00 00 00 02 D1	02
						15 01 00 00 00 00 02 D2	CB
						15 01 00 00 00 00 02 D3	02
						15 01 00 00 00 00 02 D4	E6
						15 01 00 00 00 00 02 D5	03
						15 01 00 00 00 00 02 D6	0C
						15 01 00 00 00 00 02 D7	03
						15 01 00 00 00 00 02 D8	26
						15 01 00 00 00 00 02 D9	03
						15 01 00 00 00 00 02 DA	4C
						15 01 00 00 00 00 02 DB	03
						15 01 00 00 00 00 02 DC	57
						15 01 00 00 00 00 02 DD	03
						15 01 00 00 00 00 02 DE	63
						15 01 00 00 00 00 02 DF	03
						15 01 00 00 00 00 02 E0	71
						15 01 00 00 00 00 02 E1	03
						15 01 00 00 00 00 02 E2	82
						15 01 00 00 00 00 02 E3	03
						15 01 00 00 00 00 02 E4	95
						15 01 00 00 00 00 02 E5	03
						15 01 00 00 00 00 02 E6	AE
						15 01 00 00 00 00 02 E7	03
						15 01 00 00 00 00 02 E8	CD
						15 01 00 00 00 00 02 E9	03
						15 01 00 00 00 00 02 EA	D8
						15 01 00 00 00 00 02 FF	10]; //page change
                

                qcom,mdss-dsi-gamma22-command = [15 01 00 00 00 00 02 FF 20
						15 01 00 00 00 00 02 75	00
						15 01 00 00 00 00 02 76	1D
						15 01 00 00 00 00 02 77	00
						15 01 00 00 00 00 02 78	3A
						15 01 00 00 00 00 02 79	00
						15 01 00 00 00 00 02 7A	67
						15 01 00 00 00 00 02 7B	00
						15 01 00 00 00 00 02 7C	8A
						15 01 00 00 00 00 02 7D	00
						15 01 00 00 00 00 02 7E	A6
						15 01 00 00 00 00 02 7F	00
						15 01 00 00 00 00 02 80	BD
						15 01 00 00 00 00 02 81	00
						15 01 00 00 00 00 02 82	D2
						15 01 00 00 00 00 02 83	00
						15 01 00 00 00 00 02 84	E4
						15 01 00 00 00 00 02 85	00
						15 01 00 00 00 00 02 86	F4
						15 01 00 00 00 00 02 87	01
						15 01 00 00 00 00 02 88	28
						15 01 00 00 00 00 02 89	01
						15 01 00 00 00 00 02 8A	52
						15 01 00 00 00 00 02 8B	01
						15 01 00 00 00 00 02 8C	8E
						15 01 00 00 00 00 02 8D	01
						15 01 00 00 00 00 02 8E	BA
						15 01 00 00 00 00 02 8F	01
						15 01 00 00 00 00 02 90	FC
						15 01 00 00 00 00 02 91	02
						15 01 00 00 00 00 02 92	31
						15 01 00 00 00 00 02 93	02
						15 01 00 00 00 00 02 94	33
						15 01 00 00 00 00 02 95	02
						15 01 00 00 00 00 02 96	65
						15 01 00 00 00 00 02 97	02
						15 01 00 00 00 00 02 98	AA
						15 01 00 00 00 00 02 99	02
						15 01 00 00 00 00 02 9A	D7
						15 01 00 00 00 00 02 9B	03
						15 01 00 00 00 00 02 9C	0E
						15 01 00 00 00 00 02 9D	03
						15 01 00 00 00 00 02 9E	2E
						15 01 00 00 00 00 02 9F	03
						15 01 00 00 00 00 02 A0	58
						15 01 00 00 00 00 02 A2	03
						15 01 00 00 00 00 02 A3	64
						15 01 00 00 00 00 02 A4	03
						15 01 00 00 00 00 02 A5	71
						15 01 00 00 00 00 02 A6	03
						15 01 00 00 00 00 02 A7	81
						15 01 00 00 00 00 02 A9	03
						15 01 00 00 00 00 02 AA	92
						15 01 00 00 00 00 02 AB	03
						15 01 00 00 00 00 02 AC	A4
						15 01 00 00 00 00 02 AD	03
						15 01 00 00 00 00 02 AE	BB
						15 01 00 00 00 00 02 AF	03
						15 01 00 00 00 00 02 B0	D2
						15 01 00 00 00 00 02 B1	03
						15 01 00 00 00 00 02 B2	D8
						15 01 00 00 00 00 02 B3	00
						15 01 00 00 00 00 02 B4	57
						15 01 00 00 00 00 02 B5	00
						15 01 00 00 00 00 02 B6	75
						15 01 00 00 00 00 02 B7	00
						15 01 00 00 00 00 02 B8	A1
						15 01 00 00 00 00 02 B9	00
						15 01 00 00 00 00 02 BA	C5
						15 01 00 00 00 00 02 BB	00
						15 01 00 00 00 00 02 BC	E0
						15 01 00 00 00 00 02 BD	00
						15 01 00 00 00 00 02 BE	F8
						15 01 00 00 00 00 02 BF	01
						15 01 00 00 00 00 02 C0	0C
						15 01 00 00 00 00 02 C1	01
						15 01 00 00 00 00 02 C2	1F
						15 01 00 00 00 00 02 C3	01
						15 01 00 00 00 00 02 C4	2E
						15 01 00 00 00 00 02 C5	01
						15 01 00 00 00 00 02 C6	62
						15 01 00 00 00 00 02 C7	01
						15 01 00 00 00 00 02 C8	8D
						15 01 00 00 00 00 02 C9	01
						15 01 00 00 00 00 02 CA	C9
						15 01 00 00 00 00 02 CB	01
						15 01 00 00 00 00 02 CC	F5
						15 01 00 00 00 00 02 CD	02
						15 01 00 00 00 00 02 CE	37
						15 01 00 00 00 00 02 CF	02
						15 01 00 00 00 00 02 D0	6C
						15 01 00 00 00 00 02 D1	02
						15 01 00 00 00 00 02 D2	6E
						15 01 00 00 00 00 02 D3	02
						15 01 00 00 00 00 02 D4	A0
						15 01 00 00 00 00 02 D5	02
						15 01 00 00 00 00 02 D6	D1
						15 01 00 00 00 00 02 D7	02
						15 01 00 00 00 00 02 D8	EE
						15 01 00 00 00 00 02 D9	03
						15 01 00 00 00 00 02 DA	15
						15 01 00 00 00 00 02 DB	03
						15 01 00 00 00 00 02 DC	33
						15 01 00 00 00 00 02 DD	03
						15 01 00 00 00 00 02 DE	5B
						15 01 00 00 00 00 02 DF	03
						15 01 00 00 00 00 02 E0	67
						15 01 00 00 00 00 02 E1	03
						15 01 00 00 00 00 02 E2	74
						15 01 00 00 00 00 02 E3	03
						15 01 00 00 00 00 02 E4	82
						15 01 00 00 00 00 02 E5	03
						15 01 00 00 00 00 02 E6	93
						15 01 00 00 00 00 02 E7	03
						15 01 00 00 00 00 02 E8	A5
						15 01 00 00 00 00 02 E9	03
						15 01 00 00 00 00 02 EA	BC
						15 01 00 00 00 00 02 EB	03
						15 01 00 00 00 00 02 EC	D3
						15 01 00 00 00 00 02 ED	03
						15 01 00 00 00 00 02 EE	D8
						15 01 00 00 00 00 02 EF	00
						15 01 00 00 00 00 02 F0	AE
						15 01 00 00 00 00 02 F1	00
						15 01 00 00 00 00 02 F2	B9
						15 01 00 00 00 00 02 F3	00
						15 01 00 00 00 00 02 F4	CE
						15 01 00 00 00 00 02 F5	00
						15 01 00 00 00 00 02 F6	E1
						15 01 00 00 00 00 02 F7	00
						15 01 00 00 00 00 02 F8	F2
						15 01 00 00 00 00 02 F9	01
						15 01 00 00 00 00 02 FA	01
						15 01 00 00 00 00 02 FF	21
						15 01 00 00 00 00 02 00	01
						15 01 00 00 00 00 02 01	0E
						15 01 00 00 00 00 02 02	01
						15 01 00 00 00 00 02 03	1B
						15 01 00 00 00 00 02 04	01
						15 01 00 00 00 00 02 05	27
						15 01 00 00 00 00 02 06	01
						15 01 00 00 00 00 02 07	4E
						15 01 00 00 00 00 02 08	01
						15 01 00 00 00 00 02 09	6E
						15 01 00 00 00 00 02 0A	01
						15 01 00 00 00 00 02 0B	9F
						15 01 00 00 00 00 02 0C	01
						15 01 00 00 00 00 02 0D	C5
						15 01 00 00 00 00 02 0E	02
						15 01 00 00 00 00 02 0F	01
						15 01 00 00 00 00 02 10	02
						15 01 00 00 00 00 02 11	34
						15 01 00 00 00 00 02 12	02
						15 01 00 00 00 00 02 13	35
						15 01 00 00 00 00 02 14	02
						15 01 00 00 00 00 02 15	67
						15 01 00 00 00 00 02 16	02
						15 01 00 00 00 00 02 17	AC
						15 01 00 00 00 00 02 18	02
						15 01 00 00 00 00 02 19	D7
						15 01 00 00 00 00 02 1A	03
						15 01 00 00 00 00 02 1B	0F
						15 01 00 00 00 00 02 1C	03
						15 01 00 00 00 00 02 1D	2F
						15 01 00 00 00 00 02 1E	03
						15 01 00 00 00 00 02 1F	57
						15 01 00 00 00 00 02 20	03
						15 01 00 00 00 00 02 21	63
						15 01 00 00 00 00 02 22	03
						15 01 00 00 00 00 02 23	71
						15 01 00 00 00 00 02 24	03
						15 01 00 00 00 00 02 25	7F
						15 01 00 00 00 00 02 26	03
						15 01 00 00 00 00 02 27	8F
						15 01 00 00 00 00 02 28	03
						15 01 00 00 00 00 02 29	A3
						15 01 00 00 00 00 02 2A	03
						15 01 00 00 00 00 02 2B	BA
						15 01 00 00 00 00 02 2D	03
						15 01 00 00 00 00 02 2F	D2
						15 01 00 00 00 00 02 30	03
						15 01 00 00 00 00 02 31	D8
						15 01 00 00 00 00 02 32	00
						15 01 00 00 00 00 02 33	D2
						15 01 00 00 00 00 02 34	00
						15 01 00 00 00 00 02 35	DE
						15 01 00 00 00 00 02 36	00
						15 01 00 00 00 00 02 37	F3
						15 01 00 00 00 00 02 38	01
						15 01 00 00 00 00 02 39	07
						15 01 00 00 00 00 02 3A	01
						15 01 00 00 00 00 02 3B	19
						15 01 00 00 00 00 02 3D	01
						15 01 00 00 00 00 02 3F	28
						15 01 00 00 00 00 02 40	01
						15 01 00 00 00 00 02 41	36
						15 01 00 00 00 00 02 42	01
						15 01 00 00 00 00 02 43	43
						15 01 00 00 00 00 02 44	01
						15 01 00 00 00 00 02 45	50
						15 01 00 00 00 00 02 46	01
						15 01 00 00 00 00 02 47	78
						15 01 00 00 00 00 02 48	01
						15 01 00 00 00 00 02 49	9B
						15 01 00 00 00 00 02 4A	01
						15 01 00 00 00 00 02 4B	D0
						15 01 00 00 00 00 02 4C	01
						15 01 00 00 00 00 02 4D	FA
						15 01 00 00 00 00 02 4E	02
						15 01 00 00 00 00 02 4F	3C
						15 01 00 00 00 00 02 50	02
						15 01 00 00 00 00 02 51	6F
						15 01 00 00 00 00 02 52	02
						15 01 00 00 00 00 02 53	70
						15 01 00 00 00 00 02 54	02
						15 01 00 00 00 00 02 55	A2
						15 01 00 00 00 00 02 56	02
						15 01 00 00 00 00 02 58	D2
						15 01 00 00 00 00 02 59	02
						15 01 00 00 00 00 02 5A	EE
						15 01 00 00 00 00 02 5B	03
						15 01 00 00 00 00 02 5C	16
						15 01 00 00 00 00 02 5D	03
						15 01 00 00 00 00 02 5E	34
						15 01 00 00 00 00 02 5F	03
						15 01 00 00 00 00 02 60	5A
						15 01 00 00 00 00 02 61	03
						15 01 00 00 00 00 02 62	66
						15 01 00 00 00 00 02 63	03
						15 01 00 00 00 00 02 64	73
						15 01 00 00 00 00 02 65	03
						15 01 00 00 00 00 02 66	81
						15 01 00 00 00 00 02 67	03
						15 01 00 00 00 00 02 68	91
						15 01 00 00 00 00 02 69	03
						15 01 00 00 00 00 02 6A	A4
						15 01 00 00 00 00 02 6B	03
						15 01 00 00 00 00 02 6C	BB
						15 01 00 00 00 00 02 6D	03
						15 01 00 00 00 00 02 6E	D2
						15 01 00 00 00 00 02 6F	03
						15 01 00 00 00 00 02 70	D8
						15 01 00 00 00 00 02 71	00
						15 01 00 00 00 00 02 72	F4
						15 01 00 00 00 00 02 73	00
						15 01 00 00 00 00 02 74	FC
						15 01 00 00 00 00 02 75	01
						15 01 00 00 00 00 02 76	0A
						15 01 00 00 00 00 02 77	01
						15 01 00 00 00 00 02 78	17
						15 01 00 00 00 00 02 79	01
						15 01 00 00 00 00 02 7A	23
						15 01 00 00 00 00 02 7B	01
						15 01 00 00 00 00 02 7C	2F
						15 01 00 00 00 00 02 7D	01
						15 01 00 00 00 00 02 7E	3B
						15 01 00 00 00 00 02 7F	01
						15 01 00 00 00 00 02 80	4C
						15 01 00 00 00 00 02 81	01
						15 01 00 00 00 00 02 82	4C
						15 01 00 00 00 00 02 83	01
						15 01 00 00 00 00 02 84	6C
						15 01 00 00 00 00 02 85	01
						15 01 00 00 00 00 02 86	87
						15 01 00 00 00 00 02 87	01
						15 01 00 00 00 00 02 88	B2
						15 01 00 00 00 00 02 89	01
						15 01 00 00 00 00 02 8A	D3
						15 01 00 00 00 00 02 8B	02
						15 01 00 00 00 00 02 8C	09
						15 01 00 00 00 00 02 8D	02
						15 01 00 00 00 00 02 8E	3B
						15 01 00 00 00 00 02 8F	02
						15 01 00 00 00 00 02 90	3C
						15 01 00 00 00 00 02 91	02
						15 01 00 00 00 00 02 92	6E
						15 01 00 00 00 00 02 93	02
						15 01 00 00 00 00 02 94	B2
						15 01 00 00 00 00 02 95	02
						15 01 00 00 00 00 02 96	DE
						15 01 00 00 00 00 02 97	03
						15 01 00 00 00 00 02 98	16
						15 01 00 00 00 00 02 99	03
						15 01 00 00 00 00 02 9A	36
						15 01 00 00 00 00 02 9B	03
						15 01 00 00 00 00 02 9C	5E
						15 01 00 00 00 00 02 9D	03
						15 01 00 00 00 00 02 9E	69
						15 01 00 00 00 00 02 9F	03
						15 01 00 00 00 00 02 A0	77
						15 01 00 00 00 00 02 A2	03
						15 01 00 00 00 00 02 A3	85
						15 01 00 00 00 00 02 A4	03
						15 01 00 00 00 00 02 A5	95
						15 01 00 00 00 00 02 A6	03
						15 01 00 00 00 00 02 A7	A8
						15 01 00 00 00 00 02 A9	03
						15 01 00 00 00 00 02 AA	BF
						15 01 00 00 00 00 02 AB	03
						15 01 00 00 00 00 02 AC	D3
						15 01 00 00 00 00 02 AD	03
						15 01 00 00 00 00 02 AE	D8
						15 01 00 00 00 00 02 AF	01
						15 01 00 00 00 00 02 B0	0D
						15 01 00 00 00 00 02 B1	01
						15 01 00 00 00 00 02 B2	16
						15 01 00 00 00 00 02 B3	01
						15 01 00 00 00 00 02 B4	25
						15 01 00 00 00 00 02 B5	01
						15 01 00 00 00 00 02 B6	32
						15 01 00 00 00 00 02 B7	01
						15 01 00 00 00 00 02 B8	40
						15 01 00 00 00 00 02 B9	01
						15 01 00 00 00 00 02 BA	4C
						15 01 00 00 00 00 02 BB	01
						15 01 00 00 00 00 02 BC	59
						15 01 00 00 00 00 02 BD	01
						15 01 00 00 00 00 02 BE	6B
						15 01 00 00 00 00 02 BF	01
						15 01 00 00 00 00 02 C0	6C
						15 01 00 00 00 00 02 C1	01
						15 01 00 00 00 00 02 C2	8F
						15 01 00 00 00 00 02 C3	01
						15 01 00 00 00 00 02 C4	AD
						15 01 00 00 00 00 02 C5	01
						15 01 00 00 00 00 02 C6	DF
						15 01 00 00 00 00 02 C7	02
						15 01 00 00 00 00 02 C8	06
						15 01 00 00 00 00 02 C9	02
						15 01 00 00 00 00 02 CA	44
						15 01 00 00 00 00 02 CB	02
						15 01 00 00 00 00 02 CC	76
						15 01 00 00 00 00 02 CD	02
						15 01 00 00 00 00 02 CE	77
						15 01 00 00 00 00 02 CF	02
						15 01 00 00 00 00 02 D0	A9
						15 01 00 00 00 00 02 D1	02
						15 01 00 00 00 00 02 D2	D8
						15 01 00 00 00 00 02 D3	02
						15 01 00 00 00 00 02 D4	F4
						15 01 00 00 00 00 02 D5	03
						15 01 00 00 00 00 02 D6	1D
						15 01 00 00 00 00 02 D7	03
						15 01 00 00 00 00 02 D8	3B
						15 01 00 00 00 00 02 D9	03
						15 01 00 00 00 00 02 DA	61
						15 01 00 00 00 00 02 DB	03
						15 01 00 00 00 00 02 DC	6C
						15 01 00 00 00 00 02 DD	03
						15 01 00 00 00 00 02 DE	79
						15 01 00 00 00 00 02 DF	03
						15 01 00 00 00 00 02 E0	87
						15 01 00 00 00 00 02 E1	03
						15 01 00 00 00 00 02 E2	97
						15 01 00 00 00 00 02 E3	03
						15 01 00 00 00 00 02 E4	A9
						15 01 00 00 00 00 02 E5	03
						15 01 00 00 00 00 02 E6	BF
						15 01 00 00 00 00 02 E7	03
						15 01 00 00 00 00 02 E8	D3
						15 01 00 00 00 00 02 E9	03
						15 01 00 00 00 00 02 EA	D8
						15 01 00 00 00 00 02 FF	10];
						
						
						
                qcom,mdss-dsi-gamma24-command = [15 01 00 00 00 00 02 FF 20
						15 01 00 00 00 00 02 75	00
						15 01 00 00 00 00 02 76	1D
						15 01 00 00 00 00 02 77	00
						15 01 00 00 00 00 02 78	3C
						15 01 00 00 00 00 02 79	00
						15 01 00 00 00 00 02 7A	6B
						15 01 00 00 00 00 02 7B	00
						15 01 00 00 00 00 02 7C	90
						15 01 00 00 00 00 02 7D	00
						15 01 00 00 00 00 02 7E	AD
						15 01 00 00 00 00 02 7F	00
						15 01 00 00 00 00 02 80	C5
						15 01 00 00 00 00 02 81	00
						15 01 00 00 00 00 02 82	DA
						15 01 00 00 00 00 02 83	00
						15 01 00 00 00 00 02 84	ED
						15 01 00 00 00 00 02 85	00
						15 01 00 00 00 00 02 86	FC
						15 01 00 00 00 00 02 87	01
						15 01 00 00 00 00 02 88	32
						15 01 00 00 00 00 02 89	01
						15 01 00 00 00 00 02 8A	5B
						15 01 00 00 00 00 02 8B	01
						15 01 00 00 00 00 02 8C	98
						15 01 00 00 00 00 02 8D	01
						15 01 00 00 00 00 02 8E	C3
						15 01 00 00 00 00 02 8F	02
						15 01 00 00 00 00 02 90	07
						15 01 00 00 00 00 02 91	02
						15 01 00 00 00 00 02 92	3D
						15 01 00 00 00 00 02 93	02
						15 01 00 00 00 00 02 94	3F
						15 01 00 00 00 00 02 95	02
						15 01 00 00 00 00 02 96	76
						15 01 00 00 00 00 02 97	02
						15 01 00 00 00 00 02 98	BF
						15 01 00 00 00 00 02 99	02
						15 01 00 00 00 00 02 9A	EE
						15 01 00 00 00 00 02 9B	03
						15 01 00 00 00 00 02 9C	23
						15 01 00 00 00 00 02 9D	03
						15 01 00 00 00 00 02 9E	45
						15 01 00 00 00 00 02 9F	03
						15 01 00 00 00 00 02 A0	6D
						15 01 00 00 00 00 02 A2	03
						15 01 00 00 00 00 02 A3	79
						15 01 00 00 00 00 02 A4	03
						15 01 00 00 00 00 02 A5	87
						15 01 00 00 00 00 02 A6	03
						15 01 00 00 00 00 02 A7	95
						15 01 00 00 00 00 02 A9	03
						15 01 00 00 00 00 02 AA	A3
						15 01 00 00 00 00 02 AB	03
						15 01 00 00 00 00 02 AC	B6
						15 01 00 00 00 00 02 AD	03
						15 01 00 00 00 00 02 AE	C6
						15 01 00 00 00 00 02 AF	03
						15 01 00 00 00 00 02 B0	D5
						15 01 00 00 00 00 02 B1	03
						15 01 00 00 00 00 02 B2	D8
						15 01 00 00 00 00 02 B3	00
						15 01 00 00 00 00 02 B4	57
						15 01 00 00 00 00 02 B5	00
						15 01 00 00 00 00 02 B6	77
						15 01 00 00 00 00 02 B7	00
						15 01 00 00 00 00 02 B8	A5
						15 01 00 00 00 00 02 B9	00
						15 01 00 00 00 00 02 BA	CB
						15 01 00 00 00 00 02 BB	00
						15 01 00 00 00 00 02 BC	E7
						15 01 00 00 00 00 02 BD	00
						15 01 00 00 00 00 02 BE	FF
						15 01 00 00 00 00 02 BF	01
						15 01 00 00 00 00 02 C0	15
						15 01 00 00 00 00 02 C1	01
						15 01 00 00 00 00 02 C2	28
						15 01 00 00 00 00 02 C3	01
						15 01 00 00 00 00 02 C4	36
						15 01 00 00 00 00 02 C5	01
						15 01 00 00 00 00 02 C6	6C
						15 01 00 00 00 00 02 C7	01
						15 01 00 00 00 00 02 C8	96
						15 01 00 00 00 00 02 C9	01
						15 01 00 00 00 00 02 CA	D3
						15 01 00 00 00 00 02 CB	01
						15 01 00 00 00 00 02 CC	FE
						15 01 00 00 00 00 02 CD	02
						15 01 00 00 00 00 02 CE	42
						15 01 00 00 00 00 02 CF	02
						15 01 00 00 00 00 02 D0	78
						15 01 00 00 00 00 02 D1	02
						15 01 00 00 00 00 02 D2	7A
						15 01 00 00 00 00 02 D3	02
						15 01 00 00 00 00 02 D4	AC
						15 01 00 00 00 00 02 D5	02
						15 01 00 00 00 00 02 D6	DF
						15 01 00 00 00 00 02 D7	02
						15 01 00 00 00 00 02 D8	FE
						15 01 00 00 00 00 02 D9	03
						15 01 00 00 00 00 02 DA	29
						15 01 00 00 00 00 02 DB	03
						15 01 00 00 00 00 02 DC	49
						15 01 00 00 00 00 02 DD	03
						15 01 00 00 00 00 02 DE	70
						15 01 00 00 00 00 02 DF	03
						15 01 00 00 00 00 02 E0	7B
						15 01 00 00 00 00 02 E1	03
						15 01 00 00 00 00 02 E2	88
						15 01 00 00 00 00 02 E3	03
						15 01 00 00 00 00 02 E4	96
						15 01 00 00 00 00 02 E5	03
						15 01 00 00 00 00 02 E6	A4
						15 01 00 00 00 00 02 E7	03
						15 01 00 00 00 00 02 E8	B7
						15 01 00 00 00 00 02 E9	03
						15 01 00 00 00 00 02 EA	C7
						15 01 00 00 00 00 02 EB	03
						15 01 00 00 00 00 02 EC	D6
						15 01 00 00 00 00 02 ED	03
						15 01 00 00 00 00 02 EE	D8
						15 01 00 00 00 00 02 EF	00
						15 01 00 00 00 00 02 F0	AE
						15 01 00 00 00 00 02 F1	00
						15 01 00 00 00 00 02 F2	B9
						15 01 00 00 00 00 02 F3	00
						15 01 00 00 00 00 02 F4	D0
						15 01 00 00 00 00 02 F5	00
						15 01 00 00 00 00 02 F6	E5
						15 01 00 00 00 00 02 F7	00
						15 01 00 00 00 00 02 F8	F7
						15 01 00 00 00 00 02 F9	01
						15 01 00 00 00 00 02 FA	06
						15 01 00 00 00 00 02 FF	21
						15 01 00 00 00 00 02 00	01
						15 01 00 00 00 00 02 01	14
						15 01 00 00 00 00 02 02	01
						15 01 00 00 00 00 02 03	21
						15 01 00 00 00 00 02 04	01
						15 01 00 00 00 00 02 05	2D
						15 01 00 00 00 00 02 06	01
						15 01 00 00 00 00 02 07	55
						15 01 00 00 00 00 02 08	01
						15 01 00 00 00 00 02 09	75
						15 01 00 00 00 00 02 0A	01
						15 01 00 00 00 00 02 0B	A8
						15 01 00 00 00 00 02 0C	01
						15 01 00 00 00 00 02 0D	CD
						15 01 00 00 00 00 02 0E	02
						15 01 00 00 00 00 02 0F	0B
						15 01 00 00 00 00 02 10	02
						15 01 00 00 00 00 02 11	3F
						15 01 00 00 00 00 02 12	02
						15 01 00 00 00 00 02 13	41
						15 01 00 00 00 00 02 14	02
						15 01 00 00 00 00 02 15	78
						15 01 00 00 00 00 02 16	02
						15 01 00 00 00 00 02 17	C0
						15 01 00 00 00 00 02 18	02
						15 01 00 00 00 00 02 19	EE
						15 01 00 00 00 00 02 1A	03
						15 01 00 00 00 00 02 1B	24
						15 01 00 00 00 00 02 1C	03
						15 01 00 00 00 00 02 1D	45
						15 01 00 00 00 00 02 1E	03
						15 01 00 00 00 00 02 1F	6C
						15 01 00 00 00 00 02 20	03
						15 01 00 00 00 00 02 21	78
						15 01 00 00 00 00 02 22	03
						15 01 00 00 00 00 02 23	85
						15 01 00 00 00 00 02 24	03
						15 01 00 00 00 00 02 25	92
						15 01 00 00 00 00 02 26	03
						15 01 00 00 00 00 02 27	A2
						15 01 00 00 00 00 02 28	03
						15 01 00 00 00 00 02 29	B5
						15 01 00 00 00 00 02 2A	03
						15 01 00 00 00 00 02 2B	C5
						15 01 00 00 00 00 02 2D	03
						15 01 00 00 00 00 02 2F	D5
						15 01 00 00 00 00 02 30	03
						15 01 00 00 00 00 02 31	D8
						15 01 00 00 00 00 02 32	00
						15 01 00 00 00 00 02 33	D2
						15 01 00 00 00 00 02 34	00
						15 01 00 00 00 00 02 35	DF
						15 01 00 00 00 00 02 36	00
						15 01 00 00 00 00 02 37	F5
						15 01 00 00 00 00 02 38	01
						15 01 00 00 00 00 02 39	0B
						15 01 00 00 00 00 02 3A	01
						15 01 00 00 00 00 02 3B	1E
						15 01 00 00 00 00 02 3D	01
						15 01 00 00 00 00 02 3F	2D
						15 01 00 00 00 00 02 40	01
						15 01 00 00 00 00 02 41	3C
						15 01 00 00 00 00 02 42	01
						15 01 00 00 00 00 02 43	4A
						15 01 00 00 00 00 02 44	01
						15 01 00 00 00 00 02 45	56
						15 01 00 00 00 00 02 46	01
						15 01 00 00 00 00 02 47	80
						15 01 00 00 00 00 02 48	01
						15 01 00 00 00 00 02 49	A3
						15 01 00 00 00 00 02 4A	01
						15 01 00 00 00 00 02 4B	DA
						15 01 00 00 00 00 02 4C	02
						15 01 00 00 00 00 02 4D	03
						15 01 00 00 00 00 02 4E	02
						15 01 00 00 00 00 02 4F	46
						15 01 00 00 00 00 02 50	02
						15 01 00 00 00 00 02 51	7A
						15 01 00 00 00 00 02 52	02
						15 01 00 00 00 00 02 53	7C
						15 01 00 00 00 00 02 54	02
						15 01 00 00 00 00 02 55	AE
						15 01 00 00 00 00 02 56	02
						15 01 00 00 00 00 02 58	DF
						15 01 00 00 00 00 02 59	02
						15 01 00 00 00 00 02 5A	FF
						15 01 00 00 00 00 02 5B	03
						15 01 00 00 00 00 02 5C	2A
						15 01 00 00 00 00 02 5D	03
						15 01 00 00 00 00 02 5E	49
						15 01 00 00 00 00 02 5F	03
						15 01 00 00 00 00 02 60	6F
						15 01 00 00 00 00 02 61	03
						15 01 00 00 00 00 02 62	7A
						15 01 00 00 00 00 02 63	03
						15 01 00 00 00 00 02 64	86
						15 01 00 00 00 00 02 65	03
						15 01 00 00 00 00 02 66	94
						15 01 00 00 00 00 02 67	03
						15 01 00 00 00 00 02 68	A3
						15 01 00 00 00 00 02 69	03
						15 01 00 00 00 00 02 6A	B6
						15 01 00 00 00 00 02 6B	03
						15 01 00 00 00 00 02 6C	C6
						15 01 00 00 00 00 02 6D	03
						15 01 00 00 00 00 02 6E	D5
						15 01 00 00 00 00 02 6F	03
						15 01 00 00 00 00 02 70	D8
						15 01 00 00 00 00 02 71	00
						15 01 00 00 00 00 02 72	F4
						15 01 00 00 00 00 02 73	00
						15 01 00 00 00 00 02 74	FC
						15 01 00 00 00 00 02 75	01
						15 01 00 00 00 00 02 76	0B
						15 01 00 00 00 00 02 77	01
						15 01 00 00 00 00 02 78	19
						15 01 00 00 00 00 02 79	01
						15 01 00 00 00 00 02 7A	26
						15 01 00 00 00 00 02 7B	01
						15 01 00 00 00 00 02 7C	33
						15 01 00 00 00 00 02 7D	01
						15 01 00 00 00 00 02 7E	43
						15 01 00 00 00 00 02 7F	01
						15 01 00 00 00 00 02 80	4C
						15 01 00 00 00 00 02 81	01
						15 01 00 00 00 00 02 82	51
						15 01 00 00 00 00 02 83	01
						15 01 00 00 00 00 02 84	72
						15 01 00 00 00 00 02 85	01
						15 01 00 00 00 00 02 86	8D
						15 01 00 00 00 00 02 87	01
						15 01 00 00 00 00 02 88	B9
						15 01 00 00 00 00 02 89	01
						15 01 00 00 00 00 02 8A	DA
						15 01 00 00 00 00 02 8B	02
						15 01 00 00 00 00 02 8C	13
						15 01 00 00 00 00 02 8D	02
						15 01 00 00 00 00 02 8E	46
						15 01 00 00 00 00 02 8F	02
						15 01 00 00 00 00 02 90	48
						15 01 00 00 00 00 02 91	02
						15 01 00 00 00 00 02 92	7F
						15 01 00 00 00 00 02 93	02
						15 01 00 00 00 00 02 94	C6
						15 01 00 00 00 00 02 95	02
						15 01 00 00 00 00 02 96	F5
						15 01 00 00 00 00 02 97	03
						15 01 00 00 00 00 02 98	2B
						15 01 00 00 00 00 02 99	03
						15 01 00 00 00 00 02 9A	4C
						15 01 00 00 00 00 02 9B	03
						15 01 00 00 00 00 02 9C	72
						15 01 00 00 00 00 02 9D	03
						15 01 00 00 00 00 02 9E	7E
						15 01 00 00 00 00 02 9F	03
						15 01 00 00 00 00 02 A0	8A
						15 01 00 00 00 00 02 A2	03
						15 01 00 00 00 00 02 A3	98
						15 01 00 00 00 00 02 A4	03
						15 01 00 00 00 00 02 A5	A7
						15 01 00 00 00 00 02 A6	03
						15 01 00 00 00 00 02 A7	B9
						15 01 00 00 00 00 02 A9	03
						15 01 00 00 00 00 02 AA	C8
						15 01 00 00 00 00 02 AB	03
						15 01 00 00 00 00 02 AC	D6
						15 01 00 00 00 00 02 AD	03
						15 01 00 00 00 00 02 AE	D8
						15 01 00 00 00 00 02 AF	01
						15 01 00 00 00 00 02 B0	0D
						15 01 00 00 00 00 02 B1	01
						15 01 00 00 00 00 02 B2	16
						15 01 00 00 00 00 02 B3	01
						15 01 00 00 00 00 02 B4	26
						15 01 00 00 00 00 02 B5	01
						15 01 00 00 00 00 02 B6	35
						15 01 00 00 00 00 02 B7	01
						15 01 00 00 00 00 02 B8	43
						15 01 00 00 00 00 02 B9	01
						15 01 00 00 00 00 02 BA	51
						15 01 00 00 00 00 02 BB	01
						15 01 00 00 00 00 02 BC	61
						15 01 00 00 00 00 02 BD	01
						15 01 00 00 00 00 02 BE	6C
						15 01 00 00 00 00 02 BF	01
						15 01 00 00 00 00 02 C0	71
						15 01 00 00 00 00 02 C1	01
						15 01 00 00 00 00 02 C2	96
						15 01 00 00 00 00 02 C3	01
						15 01 00 00 00 00 02 C4	B4
						15 01 00 00 00 00 02 C5	01
						15 01 00 00 00 00 02 C6	E8
						15 01 00 00 00 00 02 C7	02
						15 01 00 00 00 00 02 C8	0F
						15 01 00 00 00 00 02 C9	02
						15 01 00 00 00 00 02 CA	4E
						15 01 00 00 00 00 02 CB	02
						15 01 00 00 00 00 02 CC	81
						15 01 00 00 00 00 02 CD	02
						15 01 00 00 00 00 02 CE	83
						15 01 00 00 00 00 02 CF	02
						15 01 00 00 00 00 02 D0	B5
						15 01 00 00 00 00 02 D1	02
						15 01 00 00 00 00 02 D2	E5
						15 01 00 00 00 00 02 D3	03
						15 01 00 00 00 00 02 D4	05
						15 01 00 00 00 00 02 D5	03
						15 01 00 00 00 00 02 D6	31
						15 01 00 00 00 00 02 D7	03
						15 01 00 00 00 00 02 D8	50
						15 01 00 00 00 00 02 D9	03
						15 01 00 00 00 00 02 DA	75
						15 01 00 00 00 00 02 DB	03
						15 01 00 00 00 00 02 DC	80
						15 01 00 00 00 00 02 DD	03
						15 01 00 00 00 00 02 DE	8C
						15 01 00 00 00 00 02 DF	03
						15 01 00 00 00 00 02 E0	9A
						15 01 00 00 00 00 02 E1	03
						15 01 00 00 00 00 02 E2	A8
						15 01 00 00 00 00 02 E3	03
						15 01 00 00 00 00 02 E4	B9
						15 01 00 00 00 00 02 E5	03
						15 01 00 00 00 00 02 E6	C8
						15 01 00 00 00 00 02 E7	03
						15 01 00 00 00 00 02 E8	D6
						15 01 00 00 00 00 02 E9	03
						15 01 00 00 00 00 02 EA	D8
						15 01 00 00 00 00 02 FF	10];



/*		qcom,mdss-dsi-panel-status-check-mode = "bta_check";*/
		qcom,mdss-dsi-h-sync-pulse = <1>;
		qcom,mdss-dsi-traffic-mode = "burst_mode";
		qcom,mdss-dsi-bllp-eof-power-mode;
		qcom,mdss-dsi-bllp-power-mode;
		qcom,mdss-dsi-lane-0-state;
		qcom,mdss-dsi-lane-1-state;
		qcom,mdss-dsi-lane-2-state;
		qcom,mdss-dsi-lane-3-state;
		qcom,mdss-dsi-wr-mem-start = <0x2c>;
		qcom,mdss-dsi-te-pin-select = <1>;
		qcom,mdss-dsi-te-dcs-command = <1>;
		qcom,mdss-dsi-te-check-enable;
		qcom,mdss-dsi-te-using-te-pin;
		/*
		//qcom,mdss-dsi-panel-timings = [E2 36 24 00 66 6A 2A 3A 6A 04 05 00];//870MHZ, 8
		//qcom,mdss-dsi-t-clk-post = <0x1C>; //870MHZ, 8
		//qcom,mdss-dsi-t-clk-pre = <0x31>; //870MHZ, 8
//		qcom,mdss-dsi-panel-timings = [FB 3E 2A 00 70 74 2E 42 33 03 04 00]; // escclk - 19.2
		qcom,mdss-dsi-panel-timings = [CF 44 37 00 5E 54 3A 46 6A 03 04 00]; //870MHZ, escclk 8, 78excel...

//		qcom,mdss-dsi-t-clk-post = <0x02>;
//		qcom,mdss-dsi-t-clk-pre = <0x2E>;				
		qcom,mdss-dsi-t-clk-post = <0x1E>; // 870MHZ, escclk 8, 78excel...
		qcom,mdss-dsi-t-clk-pre = <0x37>; //870MHZ, escclk 8, 78excel...
                */

                //984/19.2 (G excel) change (T_TA_GO: Min. 4TLPX, T_TA_GET: Min 5TLPX, T_CLK_POST: Min. 377ns)
                qcom,mdss-dsi-panel-timings = [FB 3E 2A 00 70 74 2E 42 33 04 05 00]; 
                qcom,mdss-dsi-t-clk-post = <0x21>; 
                qcom,mdss-dsi-t-clk-pre = <0x2E>; 

		qcom,mdss-dsi-bl-min-level = <1>;
		qcom,mdss-dsi-bl-max-level = <216>;
		//qcom,mdss-dsi-bl-max-level = <4095>;//Parksungho, Reduce 40ms to 20ms by changing 4095 to 2048 in WLED
		qcom,mdss-dsi-dma-trigger = "trigger_sw";
		qcom,mdss-dsi-mdp-trigger = "none";
		qcom,mdss-dsi-bl-pmic-control-type = "bl_ctrl_dcs";
		//qcom,mdss-dsi-bl-pmic-control-type = "bl_ctrl_wled"; //Parksungho, for WLED
		qcom,mdss-dsi-reset-sequence = <1 20>, <0 1>, <1 20>;
		qcom,mdss-pan-physical-width-dimension = <59>;
		qcom,mdss-pan-physical-height-dimension = <104>;
/*		
		qcom,partial-update-enabled;
		qcom,panel-roi-alignment = <2 2 2 2 0 0>;
*/
	};
};

