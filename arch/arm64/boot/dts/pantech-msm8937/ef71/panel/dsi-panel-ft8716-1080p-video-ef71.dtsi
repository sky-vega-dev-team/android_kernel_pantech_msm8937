/* Copyright (c) 2013, The Linux Foundation. All rights reserved.
 *
 * This program is free software; you can redistribute it and/or modify
 * it under the terms of the GNU General Public License version 2 and
 * only version 2 as published by the Free Software Foundation.
 *
 * This program is distributed in the hope that it will be useful,
 * but WITHOUT ANY WARRANTY; without even the implied warranty of
 * MERCHANTABILITY or FITNESS FOR A PARTICULAR PURPOSE.  See the
 * GNU General Public License for more details.
 */

/*
 * FocalTech FT8716 1080p video mode panel of the EF71AS (IM-100S with the
 * larger screen). Values taken from the stock EF71AS boot image (IM-100S
 * S0228134 era). The bootloader passes this panel's name in mdss_mdp.panel
 * when it finds it, so it can sit next to the EF71S NT35695 panels.
 */

&mdss_mdp {
	dsi_ft8716_1080p_video_ef71: qcom,mdss_dsi_ft8716_1080p_video_ef71 {
		qcom,mdss-dsi-panel-name = "ft8716 1080p video mode dsi panel";
		qcom,mdss-dsi-panel-controller = <&mdss_dsi0>;
		qcom,mdss-dsi-panel-type = "dsi_video_mode";
		qcom,mdss-dsi-panel-destination = "display_1";
		qcom,mdss-dsi-panel-framerate = <60>;
		qcom,mdss-dsi-virtual-channel-id = <0>;
		qcom,mdss-dsi-stream = <0>;
		qcom,mdss-dsi-panel-width = <1080>;
		qcom,mdss-dsi-panel-height = <1920>;
		qcom,mdss-dsi-h-front-porch = <32>;
		qcom,mdss-dsi-h-back-porch = <32>;
		qcom,mdss-dsi-h-pulse-width = <4>;
		qcom,mdss-dsi-h-sync-skew = <0>;
		qcom,mdss-dsi-v-back-porch = <16>;
		qcom,mdss-dsi-v-front-porch = <16>;
		qcom,mdss-dsi-v-pulse-width = <2>;
		qcom,mdss-dsi-h-left-border = <0>;
		qcom,mdss-dsi-h-right-border = <0>;
		qcom,mdss-dsi-v-top-border = <0>;
		qcom,mdss-dsi-v-bottom-border = <0>;
		qcom,mdss-dsi-bpp = <24>;
		qcom,mdss-dsi-color-order = "rgb_swap_rgb";
		qcom,mdss-dsi-underflow-color = <0xff>;
		qcom,mdss-dsi-border-color = <0>;
		qcom,mdss-dsi-on-command = [05 01 00 00 78 00 02 11 00
			15 01 00 00 a0 00 02 35 00
			15 01 00 00 00 00 02 53 2c
			15 01 00 00 00 00 02 55 01
			05 01 00 00 30 00 02 29 00];
		qcom,mdss-dsi-off-command = [39 01 00 00 14 00 01 28
			39 01 00 00 78 00 01 10];
		qcom,mdss-dsi-cabc-command = [15 01 00 00 00 00 02 ff 10
			15 01 00 00 00 00 02 55 01];
		qcom,mdss-dsi-bklt-long-write_type = <1>;
		qcom,mdss-dsi-on-command-state = "dsi_lp_mode";
		qcom,mdss-dsi-off-command-state = "dsi_hs_mode";
		qcom,mdss-dsi-cabc-command-state = "dsi_hs_mode";
		qcom,mdss-dsi-h-sync-pulse = <1>;
		qcom,mdss-dsi-traffic-mode = "burst_mode";
		qcom,mdss-dsi-lane-map = "lane_map_0123";
		qcom,mdss-dsi-bllp-eof-power-mode;
		qcom,mdss-dsi-bllp-power-mode;
		qcom,mdss-dsi-lane-0-state;
		qcom,mdss-dsi-lane-1-state;
		qcom,mdss-dsi-lane-2-state;
		qcom,mdss-dsi-lane-3-state;
		qcom,mdss-dsi-panel-timings = [d6 32 22 00 60 66 26 36 28 03 04 00];
		qcom,mdss-dsi-t-clk-post = <0x1e>;
		qcom,mdss-dsi-t-clk-pre = <0x38>;
		qcom,mdss-dsi-bl-min-level = <1>;
		qcom,mdss-dsi-bl-max-level = <250>;
		qcom,mdss-dsi-dma-trigger = "trigger_sw";
		qcom,mdss-dsi-mdp-trigger = "none";
		qcom,mdss-dsi-bl-pmic-control-type = "bl_ctrl_dcs";
		qcom,mdss-dsi-reset-sequence = <1 20>, <0 2>, <1 20>;
		qcom,mdss-dsi-oem-pre-en-reset = <1>;
		qcom,mdss-dsi-oem-vddio_delay = <5>;
		qcom,mdss-dsi-oem-post-reset-delay = <15>;
	};
};
