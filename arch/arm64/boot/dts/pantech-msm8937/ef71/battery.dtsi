// SPDX-License-Identifier: GPL-2.0-only

&vendor {
	mtp_batterydata: qcom,battery-data {
		/delete-node/ qcom,itech-3000mah;
		/delete-node/ qcom,ascent-3450mah;

		#include "batterydata/batterydata-ef71-2950mah.dtsi"
	};
};

/* 4.4 V cell: float at 4.42 V and terminate at 200 mA, as on the stock kernel */
&qpnp_smbcharger {
	qcom,float-voltage-mv = <4420>;
	qcom,iterm-ma = <200>;
	/*
	 * Charge faster than the stock 1800 mA (0.75C of the 2950 mAh cell),
	 * and take the BQ51221 wireless receiver on DCIN up to its 5 W
	 * (stock 700 mA)
	 */
	qcom,fastchg-current-ma = <2200>;
	qcom,dc-psy-type = "Wireless";
	qcom,dc-psy-ma = <1000>;
	/delete-property/ qcom,autoadjust-vfloat;
	/delete-property/ qcom,force-aicl-rerun;
	/delete-property/ qcom,chg-led-support;
	/delete-property/ qcom,chg-led-sw-controls;
	/delete-property/ qcom,parallel-usb-min-current-ma;
	/delete-property/ qcom,parallel-usb-9v-min-current-ma;
	/delete-property/ qcom,parallel-allowed-lowering-ma;
};
