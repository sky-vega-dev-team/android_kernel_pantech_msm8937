## drivers/input/touchscreen/ft8716/Kconfig
```kconfig
#
# FocalTech FT8716 touchscreen driver configuration
#

config TOUCHSCREEN_FT8716
	tristate "FocalTech FT8716 in-cell touchscreen"
	depends on I2C
	help
	  Say Y here to enable the FocalTech FT8716 in-cell touchscreen
	  driver (Qualcomm_Ver 1.3.1), as used by the EF71AS.

	  If unsure, say N.
```

## techpack/pantech-msm8937/Kconfig
```kconfig
menu "Pantech MSM8937 platform"
	depends on ARCH_MSM8937

config MACH_PANTECH_MSM8937
	bool "Support for Pantech MSM8937 platform"
	help
	  Say Y here to enable support for Pantech MSM8937 platform.

if MACH_PANTECH_MSM8937

source "techpack/pantech-msm8937/mach/Kconfig"
source "techpack/pantech-msm8937/input/Kconfig"
source "techpack/pantech-msm8937/leds/Kconfig"
source "techpack/pantech-msm8937/touchscreen/Kconfig"

config PANTECH_CAMERA
	bool "Pantech changes to the legacy (Marshmallow) camera driver"
	depends on MSMB_CAMERA_LEGACY_M
	help
	  Carry the Pantech camera_v2 changes the EF71 camera blobs rely on
	  in techpack/camera-legacy-m: the DVDD/IOVDD/AVDD/VDDIO enable
	  GPIOs of the sensor power sequences and the VCM park steps.

endif # MACH_PANTECH_MSM8937

endmenu
```

## techpack/pantech-msm8937/input/Kconfig
```kconfig
config INPUT_GPIO_WHEEL_ALPS_EC05E
	bool "Pantech ALPS EC05E GPIO wheel"
	depends on GPIOLIB && INPUT
	help
	  The rotary wheel of the EF71 (volume keys by default), read from
	  its two encoder terminals on GPIOs.
```

## techpack/pantech-msm8937/leds/Kconfig
```kconfig
config LEDS_LP5523_PANTECH
	bool "Pantech LP5523 LED driver"
	depends on I2C && LEDS_CLASS
	help
	  Pantech's own driver for the LP5523 notification LEDs of the EF71,
	  with the rainbow while booting. Not the upstream LEDS_LP5523.
```

## techpack/pantech-msm8937/power/Kconfig
```kconfig
config EF71_WIRELESS
	bool "EF71 wireless charging input"
	depends on POWER_SUPPLY && GPIOLIB && QPNP_SMBCHARGER
	help
	  Hold the MAX14731 input switch of the EF71 in its stock state and
	  suspend the PMI8950 DCIN, where the BQ51221 wireless receiver
	  feeds in, while USB is plugged in as well. qpnp-smbcharger does
	  the charging.
```

## techpack/pantech-msm8937/touchscreen/Kconfig
```kconfig
config TOUCHSCREEN_ATMEL_MXT641T_PANTECH
	bool "Pantech Atmel mXT641T touchscreen"
	depends on I2C && INPUT_TOUCHSCREEN
	help
	  Pantech's Atmel mXT641T driver, used with the NT35695 panel of
	  the EF71S.

config TOUCHSCREEN_FT8716_PANTECH
	bool "FocalTech FT8716 in-cell touchscreen (EF71AS)"
	depends on I2C && INPUT_TOUCHSCREEN
	help
	  FocalTech's FT8716 driver (Qualcomm_Ver 1.3.1), as used with the
	  FT8716 panel of the EF71AS.
```
